## meta-amd/meta-amd-bsp/conf/machine/include/ethanolx.inc
```bitbake
require conf/machine/include/x86/x86-base.inc

# Setup a getty on all serial ports
SERIAL_CONSOLES = "115200;ttyS0"

# Enable the kernel console on ttyS0
APPEND += "console=tty0 console=ttyS0,115200n8"

MACHINE_FEATURES += "efi"
```

## meta-amd/meta-amd-bsp/conf/machine/include/tune-amd64.inc
```bitbake
DEFAULTTUNE ?= "amd64"

require conf/machine/include/x86/arch-x86.inc
require conf/machine/include/x86/x86-base.inc

# AMD x86 64-bit
TUNEVALID[amd64] = "Enable AMD x86 (64 bit) specific processor optimizations"
TUNECONFLICTS[amd64] = "m32 mx32"

# Extra tune selections
AVAILTUNES += "amd64"
TUNE_FEATURES:tune-amd64 = "m64"
BASE_LIB:tune-amd64 = "lib64"
TUNE_PKGARCH:tune-amd64 = "amd64"
PACKAGE_EXTRA_ARCHS:tune-amd64 = "${TUNE_PKGARCH:tune-amd64}"
```

## meta-amd/meta-amd-bsp/conf/machine/include/tune-zen3.inc
```bitbake
DEFAULTTUNE ?= "zen3"

require conf/machine/include/tune-zen2.inc

TUNEVALID[zen3] = "Enable AMD x86 (64 bit) Zen 3 Core Architecture specific optimizations"
TUNECONFLICTS[zen3] = "m32 mx32"

TUNE_CCARGS .= "${@bb.utils.contains('TUNE_FEATURES', 'zen3', ' -march=znver3', '', d)}"
MACHINEOVERRIDES =. "${@bb.utils.contains('TUNE_FEATURES', 'zen3', 'zen3:', '', d)}"

AVAILTUNES += "zen3"
TUNE_FEATURES:tune-zen3         = "${TUNE_FEATURES:tune-x86-64} zen3"
TUNE_PKGARCH:tune-zen3          = "zen3"
PACKAGE_EXTRA_ARCHS:tune-zen3   = "${PACKAGE_EXTRA_ARCHS:tune-zen2} zen3"
BASE_LIB:tune-zen3              = "lib64"

# user mode qemu doesn't support zen3
MACHINE_FEATURES_BACKFILL_CONSIDERED:append = " ${@bb.utils.contains('TUNE_FEATURES', 'zen3', 'qemu-usermode', '', d)}"
```

## meta-amd/meta-amd-bsp/conf/machine/include/uart.inc
```bitbake
require conf/machine/include/x86/x86-base.inc

# ttyS4 is J39 on the board
SERIAL_CONSOLES = "115200;ttyS4"

# Enable the kernel console on ttyS4
#APPEND += "console=tty0 console=ttyS4,115200n8"
APPEND += "console=ttyS0,115200n8 console=tty0"
MACHINE_FEATURES += "efi"
```

## meta-amd/meta-amd-bsp/conf/machine/include/wallaby.inc
```bitbake
require conf/machine/include/x86/x86-base.inc

SERIAL_CONSOLES = "115200;ttyS4 115200;ttyS5"

APPEND += "console=tty0 console=ttyS4,115200n8"

MACHINE_FEATURES += "efi"
```

## meta-amd/meta-amd-bsp/conf/machine/siena.conf
```bitbake
#@TYPE: Machine
#@NAME: Siena

#@DESCRIPTION: Machine configuration for Siena systems

require conf/machine/include/tune-zen4.inc
require conf/machine/include/uart.inc
# Include common configuration
include conf/machine/common.conf
APPEND += " memmap=29G!4G"
# Essential packages for Siena
MACHINE_EXTRA_RRECOMMENDS += "git gdb make cmake gcc g++ vim libkcapi libtool util-linux libvirt elfutils usbredir libxext pavucontrol ceph libaio iscsi-initiator-utils usbredir spice-protocol spice pixman libxslt virt-viewer qemu kvmtool libtool libkcapi dmidecode stressapptest spidev-test tpm-tools kernel-modules"

# Kernel module auto-loading configuration

KERNEL_MODULE_AUTOLOAD += "nvmem_core nvme nvme-common nvmem cxl cxl_mem cxl_port cxl_core  pci-cxl cxl_acpi cxl_pmem cxl_pc"

# Package manager class
PACKAGE_CLASSES ?= "package_rpm"

CORE_IMAGE_EXTRA_INSTALL += " i2c-tools"

IMAGE_INSTALL:append = " iperf3 bridge-utils ndctl kernel-module-ntb fio stream"

CORE_IMAGE_EXTRA_INSTALL += " kernel-modules"
IMAGE_INSTALL:append = " kernel-modules nvme-cli  spitools linux-firmware spidev-test rpm opkg lshw mokutil autoconf stress-ng hwloc tpm-tools ltp numactl packagegroup-core-buildessential"
KERNEL_MODULE_AUTOLOAD += "ntb_netdev"

DISTRO_FEATURES:append = " ptest pthread tpm systemd posix-testsuite"
```

## meta-amd/meta-amd-bsp/conf/machine/v1000.conf
```bitbake
#@TYPE: Machine
#@NAME: v1000

#@DESCRIPTION: Machine configuration for Siena systems

require conf/machine/include/tune-zen1.inc
require conf/machine/include/uart.inc

MACHINE_EXTRA_RRECOMMENDS += "git gdb make cmake gcc g++ vim libkcapi libtool util-linux"
 
# Include common configuration
include conf/machine/common.conf
```

## meta-amd/meta-amd-bsp/conf/machine/v2000.conf
```bitbake
#@TYPE: Machine
#@NAME: v2000

#@DESCRIPTION: Machine configuration for Siena systems

require conf/machine/include/tune-zen2.inc
require conf/machine/include/uart.inc

MACHINE_EXTRA_RRECOMMENDS += "git gdb make cmake gcc g++ vim libkcapi libtool util-linux"
 
# Include common configuration

PREFERRED_VERSION_linux-yocto = "6.6.26"

MACHINE_EXTRA_RRECOMMENDS += "git gdb make cmake gcc g++ vim libkcapi libtool util-linux libvirt elfutils usbredir libxext pavucontrol libaio iscsi-initiator-utils usbredir spice-protocol spice pixman libxslt virt-viewer qemu kvmtool libtool libkcapi dmidecode stressapptest spidev-test"

KERNEL_MODULE_AUTOLOAD += "nvmem_core nvme nvme-common nvmem cxl cxl_mem cxl_port cxl_core spi-amd ntb_netdev spi-amd pci-cxl cxl_acpi cxl_pmem cxl_pci spi"

PACKAGE_CLASSES ?= "package_rpm"
MACHINE_EXTRA_RRECOMMENDS += "mesa libegl-mesa libegl-mesa-dev  libosmesa libosmesa-dev  libgl-mesa libgl-mesa-dev  libglx-mesa libglx-mesa-dev libglapi libglapi-dev  libgbm libgbm-dev  libgles1-mesa libgles1-mesa-dev  libgles2-mesa libgles2-mesa-dev libgles3-mesa libgles3-mesa-dev libopencl-mesa libopencl-mesa-dev libxatracker libxatracker-dev  mesa-megadriver mesa-vulkan-drivers mesa-vdpau-drivers mesa-tools"

IMAGE_INSTALL:append = " glmark2  mesa-demos linux-firmware kernel-modules"

MACHINE_ESSENTIAL_EXTRA_RRECOMMENDS += "kernel-modules"
KERNEL_MODULE_AUTOLOAD += "spi-amd"

include conf/machine/common.conf

XSERVER = "xserver-xorg \
         xf86-video-amdgpu \
         xf86-video-modesetting \
         xf86-video-fbdev \
         xf86-video-vesa \
         xf86-video-ati \
         xf86-video-intel \
         xf86-video-nouveau \
         xf86-video-vmware \
         "
```

## meta-amd/meta-amd-bsp/conf/machine/v3000.conf
```bitbake
#@TYPE: Machine
#@NAME: v3000

#@DESCRIPTION: Machine configuration for v3000 systems

require conf/machine/include/tune-zen3.inc
require conf/machine/include/fox.inc

# Include common configuration
include conf/machine/common.conf
include conf/machine/kernel.conf
```

## meta-amd/meta-amd-distro/conf/layer.conf
```bitbake
# We have a conf and classes directory, add to BBPATH
BBPATH .= ":${LAYERDIR}"
# We have recipes-* directories, add to BBFILES
BBFILES += "${LAYERDIR}/recipes*/*/*.bb \
            ${LAYERDIR}/recipes*/*/*.bbappend"

BBFILE_COLLECTIONS += "amd-distro"
BBFILE_PATTERN_amd-distro = "^${LAYERDIR}/"
BBFILE_PRIORITY_amd-distro = "12"

LAYERSERIES_COMPAT_amd-distro = "kirkstone scarthgap whinlatter"

LAYERDEPENDS_amd-distro = "core yocto"
```

## meta-amd/meta-amd-distro/scripts/lib/wic/canned-wks/amd-usbimage.wks
```
# short-description: Create USB image with files from var IMAGE_BOOT_FILES
# long-description: Creates a USB image with all files in the IMAGE_BOOT_FILES
# var e.g. bootloader, initrd, kernel & rootfs.img.

part /boot --source bootimg-partition --ondisk sda --fstype=vfat --label boot --overhead-factor 1.0 --active --align 1024
```

## meta-artesyn/conf/layer.conf
```bitbake
# We have a conf and classes directory, add to BBPATH
BBPATH .= ":${LAYERDIR}"

# We have recipes-* directories, add to BBFILES
BBFILES += "${LAYERDIR}/recipes-*/*/*.bb \
	    ${LAYERDIR}/recipes-*/*/*.bbappend"

BBFILE_COLLECTIONS += "artesyn"
BBFILE_PATTERN_artesyn = "^${LAYERDIR}/"
BBFILE_PRIORITY_artesyn = "6"

LAYERSERIES_COMPAT_artesyn = "kirkstone scarthgap walnascar"

# This should only be incremented on significant changes that will
# cause compatibility issues with other layers
LAYERVERSION_artesyn = "6"

LAYERDEPENDS_artesyn = "core"
```

## meta-artesyn/conf/machine/include/powerpc/tune-ppc7450.inc
```bitbake
DEFAULTTUNE ?= "ppc7450"

require conf/machine/include/powerpc/arch-powerpc.inc

TUNEVALID[ppc7450] = "Enable ppc7450 specific processor optimizations"
TUNE_CCARGS .= "${@bb.utils.contains('TUNE_FEATURES', 'ppc7450', ' -mcpu=7450 -mno-spe', '', d)}"

AVAILTUNES += "ppc7450"
TUNE_FEATURES:tune-ppc7450 = "m32 fpu-hard ppc7450 altivec bigendian"
TUNE_PKGARCH:tune-ppc7450 = "ppc7450"
PACKAGE_EXTRA_ARCHS:tune-ppc7450 = "${PACKAGE_EXTRA_ARCHS:tune-powerpc} ppc7450"

QEMU_EXTRAOPTIONS_ppc7450 = " -cpu 7450"
```

## meta-artesyn/conf/machine/include/tune-ppc7450.inc
```bitbake
DEFAULTTUNE ?= "ppc7450"

require conf/machine/include/powerpc/arch-powerpc.inc

TUNEVALID[ppc7450] = "Enable ppc7450 specific processor optimizations"
TUNE_CCARGS .= "${@bb.utils.contains('TUNE_FEATURES', 'ppc7450', ' -mcpu=7450 -mno-spe', '', d)}"

AVAILTUNES += "ppc7450"
TUNE_FEATURES_tune-ppc7450 = "m32 fpu-hard ppc7450 altivec bigendian"
TUNE_PKGARCH_tune-ppc7450 = "ppc7450"
PACKAGE_EXTRA_ARCHS_tune-ppc7450 = "${PACKAGE_EXTRA_ARCHS_tune-powerpc} ppc7450"

# glibc configure options to get 7450 specific library (for sqrt)
#GLIBC_EXTRA_OECONF += "${@bb.utils.contains('TUNE_FEATURES', 'ppc7450', '--with-cpu=power4', '', d)}"

QEMU_EXTRAOPTIONS_ppc7450 = " -cpu 7450"
```

## meta-artesyn/conf/machine/mvme2500.conf
```bitbake
#@TYPE: Machine
#@NAME: MVME2500 machine
#@DESCRIPTION: Machine configuration for MVME2500 https://www.artesyn.com/computing/products/product/mvme2500-series-vme64-processor-board

require conf/machine/include/artesyn.inc
require conf/machine/include/tune-ppce500v2.inc

SERIAL_CONSOLE = "9600 ttyS0"

KERNEL_IMAGETYPE = "zImage"
DEVICETREE = "mvme2500.dtb"
KERNEL_DEVICETREE = "fsl/${DEVICETREE}"

MACHINE_FEATURES = "pci serial ext2 usbhost"

IMAGE_BOOT_FILES ?= " \
	${DEVICETREE} \
	${KERNEL_IMAGETYPE} \
	"

IMAGE_FSTYPES ?= "wic"
WKS_FILE ?= "sdimage-bootpart.wks"

MACHINEOVERRIDES =. "e500v2:"
TUNE_FEATURES_tune-ppce500v2 += "spe"
```

## meta-artesyn/conf/machine/mvme5100.conf
```bitbake
#@TYPE: Machine
#@NAME: MVME5100 machine
#@DESCRIPTION: Machine configuration for MVME5100

require conf/machine/include/artesyn.inc
require conf/machine/include/powerpc/tune-ppc7400.inc

SERIAL_CONSOLE = "9600 ttyS0"

KERNEL_IMAGETYPE = "dtbImage.mvme5100"

MACHINE_FEATURES = "pci serial"

IMAGE_FSTYPES ?= "tar.gz"

ALLOW_EMPTY:${KERNEL_PACKAGE_NAME}-devicetree = "1"
```

## meta-clang-revival/conf/layer.conf
```bitbake
# We have a conf directory, append to BBPATH
BBPATH .= ":${LAYERDIR}"

# We have a recipes directory, add to BBFILES
BBFILES += " \
	${LAYERDIR}/recipes-*/*/*.bb \
	${LAYERDIR}/recipes-*/*/*.bbappend \
"

BBFILES_DYNAMIC += " \
	intel:${LAYERDIR}/dynamic-layers/intel/*/*/*.bb \
	intel:${LAYERDIR}/dynamic-layers/intel/*/*/*.bbappend \
"

BBFILE_COLLECTIONS += "clang-revival-layer"
BBFILE_PATTERN_clang-revival-layer := "^${LAYERDIR}/"
BBFILE_PRIORITY_clang-revival-layer = "8"

LAYERVERSION_clang-revival-layer = "1"
LAYERSERIES_COMPAT_clang-revival-layer = "scarthgap"

LAYERDEPENDS_clang-revival-layer = "core clang-layer"
LAYERRECOMMENDS_clang-revival-layer = "intel"

LLVM17VERSION = "17.0.6"
LLVM16VERSION = "16.0.6"
LLVM15VERSION = "15.0.7"
```

## meta-intel-fpga/conf/layer.conf
```bitbake
# We have a conf and classes directory, append to BBPATH
BBPATH .= ":${LAYERDIR}"

# We have a recipes directory, add to BBFILES
BBFILES:append = " ${LAYERDIR}/recipes*/*/*.bb ${LAYERDIR}/recipes*/*/*.bbappend"

BBFILE_COLLECTIONS:append = " meta-intel-fpga"
BBFILE_PATTERN_meta-intel-fpga := "^${LAYERDIR}/"

# Increase the layer priority
BBFILE_PRIORITY_meta-intel-fpga = "6"
LAYERSERIES_COMPAT_meta-intel-fpga = "master walnascar whinlatter"

BBDEBUG = "yes"
```

## meta-intel-fpga/conf/machine/agilex5_mucv.conf
```bitbake
#@TYPE: Machine
#@NAME: Intel SoCFPGA Agilex5
#@DESCRIPTION: Machine configuration for the Agilex5 SoCFPGA

require conf/machine/include/socfpga_armv8-2a.inc
require conf/machine/include/ubifs_agilex5.inc

KBUILD_DEFCONFIG ?= "defconfig"

UBOOT_CONFIG ??= "agilex5_mucv-socdk-atf"
UBOOT_CONFIG[agilex5_mucv-socdk-atf] = "socfpga_agilex5_defconfig"
UBOOT_BINARY = "u-boot.itb"
UBOOT_SUFFIX = "itb"

KERNEL_CLASSES:append = " kernel-fitimage"
KERNEL_IMAGETYPE = "Image"

# KERNEL_DEVICETREE ?= "\
# 			intel/socfpga_agilex5_socdk.dtb \
# 			intel/socfpga_agilex5_socdk_swvp.dtb \
# 			"
KERNEL_DEVICETREE ?= "\
			intel/socfpga_agilex5_socdk.dtb \
			"
UBOOT_ENTRYPOINT = "0x4000000"
UBOOT_LOADADDRESS = "0x4000000"
FIT_KERNEL_COMP_ALG = "none"

SERIAL_CONSOLES ?= "115200;ttyS0"

EXTRA_IMAGECMD:jffs2 ?= "-n -q -e 0x10000"

UBOOT_EXTLINUX ?= "1"
UBOOT_EXTLINUX_LABELS ?= "default"
UBOOT_EXTLINUX_DEFAULT_LABEL ?= "Agilex5 SOCDK SDMMC"

UBOOT_EXTLINUX_MENU_DESCRIPTION:default ?= "Agilex5 SOCDK SDMMC"
UBOOT_EXTLINUX_KERNEL_IMAGE:default ?= "../${KERNEL_IMAGETYPE}"
UBOOT_EXTLINUX_FDTDIR:default ?= ".."
UBOOT_EXTLINUX_CONSOLE ?= "console=ttyS0,115200n8"
UBOOT_EXTLINUX_KERNEL_ARGS:default ?= "rootwait rw earlyprintk"
UBOOT_EXTLINUX_ROOT:default ?= "root=/dev/mmcblk0p2"

# Add variables for wic creation of sdcard image
IMAGE_BOOT_FILES ?= " \
			${UBOOT_BINARY} \
			Image \
			socfpga_agilex5_socdk.dtb \
			"

WKS_FILE ?= "sdimage-stratix10-agilex.wks"
IMAGE_FSTYPES:append = " wic"
```

## meta-intel-fpga/conf/machine/agilex7_dk_dev_agf027f1es.conf
```bitbake
#@TYPE: Machine
#@NAME: Altera SoCFPGA Agilex7 DK-DEV-AGF027F1ES
#@DESCRIPTION: Machine configuration for the Agilex7 DK-DEV-AGF027F1ES SoCFPGA

require conf/machine/agilex7_dk_si_agf014eb.conf
```

## meta-intel-fpga/conf/machine/agilex7_dk_dev_agm039ea.conf
```bitbake
#@TYPE: Machine
#@NAME: Altera SoCFPGA Agilex7 DK-DEV-AGM039EA
#@DESCRIPTION: Machine configuration for the Agilex7 DK-DEV-AGM039EA SoCFPGA

require conf/machine/agilex7_dk_si_agf014eb.conf

UBOOT_CONFIG[agilex-socdk-atf] = "socfpga_agilex7m_defconfig"
UBOOT_CONFIG[agilex-socdk-qspi-atf] = "socfpga_agilex7m_defconfig"

KERNEL_DEVICETREE ?= "intel/socfpga_agilex7m_socdk.dtb"
```

## meta-intel-fpga/conf/machine/agilex7_dk_dev_agm039fes.conf
```bitbake
#@TYPE: Machine
#@NAME: Intel SoCFPGA Agilex7 DK-DEV-AGM039FES
#@DESCRIPTION: Machine configuration for the Agilex7 DK-DEV-AGM039FES SoCFPGA

require conf/machine/agilex7_dk_si_agf014ea.conf
require conf/machine/include/ubifs.inc

UBOOT_CONFIG ??= "agilex7_dk_dev_agm039fes-socdk-atf"
UBOOT_CONFIG[agilex7_dk_dev_agm039fes-socdk] = "socfpga_agilex_legacy_defconfig"
UBOOT_CONFIG[agilex7_dk_dev_agm039fes-socdk-atf] = "socfpga_agilex7m_defconfig"
UBOOT_CONFIG[agilex7_dk_dev_agm039fes-socdk-qspi] = "socfpga_agilex_qspi_legacy_defconfig"
UBOOT_CONFIG[agilex7_dk_dev_agm039fes-socdk-qspi-atf] = "socfpga_agilex7m_defconfig"

KERNEL_DEVICETREE ?= "intel/socfpga_agilex7m_socdk.dtb"
```

## meta-intel-fpga/conf/machine/agilex7_dk_si_agi027fa.conf
```bitbake
#@TYPE: Machine
#@NAME: Altera SoCFPGA Agilex7 DK-SI-AGI027FA (LINEAR)
#@DESCRIPTION: Machine configuration for the Agilex7 DK-SI-AGI027FA (LINEAR) SoCFPGA

require conf/machine/agilex7_dk_si_agf014eb.conf
```

## meta-intel-fpga/conf/machine/include/ubifs_agilex5.inc
```bitbake
# Settings for ubifs
MKUBIFS_ARGS ?= "--leb-size 1032192 --min-io-size 8192 --max-leb-cnt 8600"
UBINIZE_ARGS ?= "--peb-size 1024KiB --min-io-size 8192 --sub-page-size 8192"
MULTIUBI_BUILD += "nand"
MKUBIFS_ARGS_nand ?= "--leb-size 1032192 --min-io-size 8192 --max-leb-cnt 8600"
UBINIZE_ARGS_nand ?= "--peb-size 1024KiB --min-io-size 8192 --sub-page-size 8192"
MULTIUBI_BUILD += "nor"
MKUBIFS_ARGS_nor ?= "-F -e 65408 -m 1 -c 8600"
UBINIZE_ARGS_nor ?= "-p 65536 -m 1 -s 1"
```
