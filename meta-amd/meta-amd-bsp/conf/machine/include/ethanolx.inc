## meta-intel-fpga/conf/machine/n5x.conf
```bitbake
#@TYPE: Machine
#@NAME: Intel eASIC N5X
#@DESCRIPTION: Machine configuration for the N5X eASIC devices

require conf/machine/include/socfpga_armv8a.inc
require conf/machine/include/ubifs.inc

KBUILD_DEFCONFIG ?= "defconfig"

UBOOT_CONFIG ??= "n5x-socdk-atf"
UBOOT_CONFIG[n5x-socdk-atf] = "socfpga_n5x_defconfig"

UBOOT_BINARY = "u-boot.itb"
UBOOT_SUFFIX = "itb"

KERNEL_CLASSES += "kernel-fitimage"
KERNEL_IMAGETYPE = "Image"

KERNEL_DEVICETREE ?= "intel/socfpga_n5x_socdk.dtb"
UBOOT_ENTRYPOINT = "0x4000000"
UBOOT_LOADADDRESS = "0x4000000"
FIT_KERNEL_COMP_ALG = "none"

SERIAL_CONSOLES ?= "115200;ttyS0"

EXTRA_IMAGECMD:jffs2 ?= "-n -q -e 0x10000"

UBOOT_EXTLINUX ?= "1"
UBOOT_EXTLINUX_LABELS ?= "default"
UBOOT_EXTLINUX_DEFAULT_LABEL ?= "N5X SOCDK SDMMC"

UBOOT_EXTLINUX_MENU_DESCRIPTION:default ?= "N5X SOCDK SDMMC"
UBOOT_EXTLINUX_KERNEL_IMAGE:default ?= "../${KERNEL_IMAGETYPE}"
UBOOT_EXTLINUX_FDTDIR:default ?= ".."
UBOOT_EXTLINUX_CONSOLE ?= "console=ttyS0,115200n8"
UBOOT_EXTLINUX_KERNEL_ARGS:default ?= "rootwait rw earlyprintk"
UBOOT_EXTLINUX_ROOT:default ?= "root=/dev/mmcblk0p2"

# Add variables for wic creation of sdcard image
IMAGE_BOOT_FILES ?= " \
			${UBOOT_BINARY} \
			Image \
			socfpga_n5x_socdk.dtb \
			kernel.itb \
		    "

WKS_FILE ?= "sdimage-stratix10-agilex.wks"
IMAGE_FSTYPES:append = " wic"
```
