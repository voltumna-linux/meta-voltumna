## conf/bblayers.conf.sample
```bitbake
# LAYER_CONF_VERSION is increased each time build/conf/bblayers.conf
# changes incompatibly
LCONF_VERSION = "7"

BBPATH = "${TOPDIR}"
BBFILES ?= ""

BBLAYERS ?= " \
  ##OEROOT##/../../meta-voltumna \
  ##OEROOT##/../meta-dpdk \
  ##OEROOT##/../meta-tango \
  ##OEROOT##/../meta-mingw \
  ##OEROOT##/../meta-artesyn \
  ##OEROOT##/../meta-altera \
  ##OEROOT##/../meta-intel \
  ##OEROOT##/../meta-intel-qat \
  ##OEROOT##/../meta-arm/meta-arm \
  ##OEROOT##/../meta-arm/meta-arm-toolchain \
  ##OEROOT##/../meta-ti \
  ##OEROOT##/../meta-clang \
  ##OEROOT##/../meta-openembedded/meta-oe \
  ##OEROOT##/../meta-openembedded/meta-filesystems \
  ##OEROOT##/../meta-openembedded/meta-python \
  ##OEROOT##/../meta-openembedded/meta-networking \
  ##OEROOT##/../meta-openembedded/meta-webserver \
  ##OEROOT##/meta \
  "
```

## conf/distro/include/container-host-docker.conf
```bitbake
# Container host configuration fragment: Docker
#
# Include from local.conf to set up a Docker-based container host.
# Requires meta-virt-host.conf to be included first:
#
#   require conf/distro/include/meta-virt-host.conf
#   require conf/distro/include/container-host-docker.conf
#   MACHINE = "qemux86-64"
#   bitbake container-image-host
#
# Sets CONTAINER_PROFILE and the DISTRO_FEATURES required by
# container-image-host with the Docker engine stack.

CONTAINER_PROFILE = "docker"
```

## conf/distro/include/container-host-lxc.conf
```bitbake
# Container host configuration fragment: LXC
#
# Include from local.conf to set up an LXC-based container host:
#
#   require conf/distro/include/meta-virt-host.conf
#   require conf/distro/include/container-host-lxc.conf
#   MACHINE = "qemux86-64"
#   bitbake container-image-host
#
# Sets CONTAINER_PROFILE for LXC. LXC is the user-space toolset for
# Linux Containers (the older, system-container-oriented sibling of
# OCI runtimes like runc/crun). It's also what incus uses underneath,
# but installs lxc-* command-line tools directly without an incus
# daemon in front of them.
#
# This profile pulls in:
#   - lxc                 — the lxc-create / lxc-start / etc. binaries
#   - lxc-networking      — lxc-net.service + lxcbr0 bridge config
#   - lxc-templates       — /usr/share/lxc/templates/ scripts
#
# (lxc-networking and lxc-templates land via the lxc recipe's RRECOMMENDS,
#  so they can be dropped through BAD_RECOMMENDATIONS if needed.)

CONTAINER_PROFILE = "lxc"
```

## conf/distro/include/kvm-host.conf
```bitbake
# KVM host configuration fragment
#
# Include from local.conf for KVM/libvirt development and testing.
# Requires meta-virt-host.conf to be included first:
#
#   require conf/distro/include/meta-virt-host.conf
#   require conf/distro/include/kvm-host.conf
#   MACHINE = "qemux86-64"
#   bitbake kvm-image-minimal

DISTRO_FEATURES:append = " kvm"
```

## conf/distro/include/meta-virt-container-lxc.inc
```bitbake
include meta-virt-container.inc

# LXC is a Linux Containers user-space toolset for system containers.
# Unlike OCI engines (docker, podman, containerd) it doesn't use the
# OCI runtime/networking model — lxc-net.service brings up its own
# lxcbr0 bridge, and templates are scripts under /usr/share/lxc/templates
# rather than OCI bundles.
VIRTUAL-RUNTIME_container_engine ??= "lxc"
VIRTUAL-RUNTIME_container_runtime ??= ""
VIRTUAL-RUNTIME_container_networking ??= ""
VIRTUAL-RUNTIME_container_dns ??= ""
VIRTUAL-RUNTIME_container_orchestration ??= ""
```

## conf/distro/include/meta-virt-dev.conf
```bitbake
# QEMU development and testing settings
#
# Include from local.conf when developing and testing with runqemu:
#
#   require conf/distro/include/meta-virt-dev.conf
#
# This is separate from the build profiles (container-host-*, xen-host-*)
# and provides settings that only matter for QEMU-based development:
# image format, memory, debug features, etc.
#
# Typical local.conf for QEMU-based k3s development:
#
#   require conf/distro/include/meta-virt-host.conf
#   BUILD_PROFILE ?= "k3s"
#   require conf/distro/include/container-host-${BUILD_PROFILE}.conf
#   require conf/distro/include/meta-virt-dev.conf
#   MACHINE = "qemux86-64"

# Use raw ext4 for runqemu boot/test cycles.
# Snapshot formats (qcow2) don't work well with repeated boots.
IMAGE_FSTYPES = "ext4"

# Xen QEMU settings: Dom0 memory cap and total VM memory
QB_XEN_CMDLINE_EXTRA ?= "dom0_mem=512M"
QB_MEM ?= "-m 1024"

# Debug-friendly image features
EXTRA_IMAGE_FEATURES ?= "allow-empty-password empty-root-password allow-root-login post-install-logging"
```

## conf/distro/include/meta-virt-host.conf
```bitbake
# Base virtualization host configuration fragment
#
# Common DISTRO_FEATURES for any virtualization work: containers, Xen,
# k3s, or custom/mixed configurations.
#
# Use standalone for custom builds:
#
#   require conf/distro/include/meta-virt-host.conf
#   MACHINE = "qemux86-64"
#
# Or let a specific profile (container-host-*, xen-host-*) inherit it.

DISTRO_FEATURES:append = " virtualization systemd seccomp vmsep vcontainer"

# Container runtime provider — the unified runc recipe provides both
# runc-docker and runc-opencontainers via RPROVIDES
PREFERRED_PROVIDER_virtual/runc ?= "runc"

# Multiconfig for cross-arch builds:
#   vruntime-*   : minimal VM rootfs (vdkr/vpdmn blobs)
#   container-*  : OCI container images (multi-arch)
BBMULTICONFIG ?= "vruntime-aarch64 vruntime-x86-64 container-aarch64 container-x86-64"

# Suppress warnings for layers fully masked in vruntime/vcontainer multiconfigs.
# These layers are in bblayers.conf (needed by the main build) but their
# recipes are irrelevant to container/VM multiconfigs. BitBake checks
# BBFILE_PATTERN_IGNORE_EMPTY on self.data (the base datastore), not
# per-multiconfig, so this must be set here rather than in the distro config.
BBFILE_PATTERN_IGNORE_EMPTY_filesystems-layer = "1"
BBFILE_PATTERN_IGNORE_EMPTY_meta-python = "1"
BBFILE_PATTERN_IGNORE_EMPTY_webserver = "1"
```

## conf/distro/include/vruntime-bbmask-meta-oe.inc
```bitbake
# SPDX-FileCopyrightText: Copyright (C) 2025 Bruce Ashfield
#
# SPDX-License-Identifier: MIT
#
# BBMASK for meta-openembedded sublayers in vruntime multiconfig builds.
#
# Masks recipe categories with zero recipes in the vruntime dependency
# graph (verified via bitbake -g).
#
# KEPT from meta-oe:
#   recipes-devtools (abseil-cpp, jsoncpp, protobuf, yajl)
#   recipes-extended (jansson)
#   recipes-support (lvm2)
# KEPT from meta-networking:
#   recipes-filter (nftables, libnftnl)
#   recipes-support (bridge-utils)
# KEPT from meta-filesystems: NONE (entire layer masked)
# KEPT from meta-python: NONE (entire layer masked)
# KEPT from meta-webserver: NONE (entire layer masked)

# ---------------------------------------------------------------------------
# meta-oe: mask all categories except devtools, extended, support
# Uses negative lookahead to keep the three needed categories
# ---------------------------------------------------------------------------
BBMASK += "meta-oe/recipes-(?!devtools|extended|support)"

# ---------------------------------------------------------------------------
# meta-networking: mask all categories except filter, support
# ---------------------------------------------------------------------------
BBMASK += "meta-networking/recipes-(?!filter|support)"

# ---------------------------------------------------------------------------
# Entire layers with 0 recipes in the dependency graph.
# Clear BBFILE_COLLECTIONS entries for fully-masked layers so BitBake
# does not warn about zero files matching BBFILE_PATTERN.
# The layers remain in bblayers.conf (shared with main build) but
# contribute no recipes to vruntime/vcontainer multiconfigs.
# ---------------------------------------------------------------------------
BBMASK += "meta-filesystems/"
BBMASK += "meta-python/"
BBMASK += "meta-webserver/"
# Warning suppression for these fully-masked layers is in meta-virt-host.conf
# (BBFILE_PATTERN_IGNORE_EMPTY) because BitBake checks the base datastore,
# not per-multiconfig datastores.

# ---------------------------------------------------------------------------
# Orphaned bbappends in other layers (base recipes masked above)
# ---------------------------------------------------------------------------
# meta-openstack bbappend for meta-oe postgresql (recipes-dbs masked)
BBMASK += "meta-openstack/recipes-dbs/postgresql/"
# meta-oe dynamic-layers bbappend for meta-networking packagegroup (recipes-core masked)
BBMASK += "meta-oe/dynamic-layers/networking-layer/recipes-core/"
```

## conf/distro/include/vruntime-bbmask-oe-core.inc
```bitbake
# SPDX-FileCopyrightText: Copyright (C) 2025 Bruce Ashfield
#
# SPDX-License-Identifier: MIT
#
# BBMASK for oe-core (meta) layer in vruntime multiconfig builds.
#
# Masks entire recipe categories with zero recipes in the vruntime
# dependency graph (verified via bitbake -g and PN-level cross-check).
#
# KEPT: recipes-bsp, recipes-connectivity, recipes-core, recipes-devtools,
#       recipes-extended, recipes-gnome, recipes-kernel, recipes-support

# ---------------------------------------------------------------------------
# Graphics - mask only subdirs with zero needed recipes (39 of 49 subdirs)
# Keep: wayland, libsdl2, virglrenderer, libepoxy, drm, mesa, spir,
#       xorg-lib, xorg-proto, xorg-app, xorg-util (qemu-system-native deps)
# ---------------------------------------------------------------------------
BBMASK += "/meta/recipes-graphics/(?!wayland|libsdl2|virglrenderer|libepoxy|drm|mesa|spir|xorg-lib|xorg-proto|xorg-app|xorg-util)"

# ---------------------------------------------------------------------------
# Multimedia - mask all except alsa/ and libpng/ (qemu-system-native deps)
# ---------------------------------------------------------------------------
BBMASK += "/meta/recipes-multimedia/(?!alsa|libpng)"

# ---------------------------------------------------------------------------
# Sato desktop (~25 recipes) - Matchbox, webkit, desktop UI
# ---------------------------------------------------------------------------
BBMASK += "/meta/recipes-sato/"

# ---------------------------------------------------------------------------
# RT kernel (~4 recipes) - Real-time kernel, not needed for containers
# ---------------------------------------------------------------------------
BBMASK += "/meta/recipes-rt/"

# ---------------------------------------------------------------------------
# Orphaned bbappends in other layers (base recipes masked above)
# ---------------------------------------------------------------------------
# meta-yocto-bsp bbappend for masked oe-core graphics
BBMASK += "meta-yocto-bsp/recipes-graphics/xorg-xserver/xserver-xf86-config"
# meta-erlang bbappend for oe-core mesa (mesa is kept, but libglu not needed)
BBMASK += "meta-erlang/recipes-graphics/mesa/libglu"
```
