## conf/distro/include/vruntime-bbmask.inc
```bitbake
# SPDX-FileCopyrightText: Copyright (C) 2025 Bruce Ashfield
#
# SPDX-License-Identifier: MIT
#
# BBMASK for meta-virtualization layer in vruntime multiconfig builds.
#
# Masks recipes not needed by vdkr (docker) or vpdmn (podman) container
# runtime images. Only affects vruntime multiconfig parsing; main build
# is unaffected.
#
# Generated from bitbake -g dependency graph analysis.
#
# KEPT (.bb recipes): aardvark-dns, catatonit, conmon, containerd,
#   container-host-config, crun, docker-moby, netavark, podman, runc,
#   skopeo, tini, vcontainer/*, cni, slirp4netns
# KEPT (bbappends only): busybox, initscripts, libxcrypt, sysvinit,
#   go-md2man, qemu, yajl, iptables, libseccomp, linux/linux-yocto, bind

# ---------------------------------------------------------------------------
# Virtualization platforms (not containers)
# ---------------------------------------------------------------------------
BBMASK += "meta-virtualization/recipes-extended/xen/"
BBMASK += "meta-virtualization/recipes-extended/xvisor/"
BBMASK += "meta-virtualization/recipes-extended/kvmtool/"
BBMASK += "meta-virtualization/recipes-extended/libvirt/"
BBMASK += "meta-virtualization/recipes-extended/libvmi/"
BBMASK += "meta-virtualization/recipes-extended/virt-manager/"
BBMASK += "meta-virtualization/recipes-extended/virt-viewer/"
BBMASK += "meta-virtualization/recipes-extended/virt-what/"
BBMASK += "meta-virtualization/recipes-extended/vhost-device/"
BBMASK += "meta-virtualization/recipes-extended/dev86/"
BBMASK += "meta-virtualization/recipes-extended/seabios/"
BBMASK += "meta-virtualization/recipes-extended/vgabios/"
BBMASK += "meta-virtualization/recipes-extended/upx/"
BBMASK += "meta-virtualization/recipes-extended/uxen/"
BBMASK += "meta-virtualization/recipes-extended/ipxe/"
BBMASK += "meta-virtualization/recipes-extended/diod/"
BBMASK += "meta-virtualization/recipes-extended/virtiofsd/"

# ---------------------------------------------------------------------------
# Infrastructure / monitoring
# ---------------------------------------------------------------------------
BBMASK += "meta-virtualization/recipes-extended/ceph/"
BBMASK += "meta-virtualization/recipes-extended/cloud-init/"
BBMASK += "meta-virtualization/recipes-extended/cockpit-machines/"
BBMASK += "meta-virtualization/recipes-extended/nagios/"
BBMASK += "meta-virtualization/recipes-extended/oath/"
BBMASK += "meta-virtualization/recipes-extended/irqbalance/"

# ---------------------------------------------------------------------------
# Container images / bundles / cross-deploy (main build only)
# ---------------------------------------------------------------------------
BBMASK += "meta-virtualization/recipes-extended/images/"
BBMASK += "meta-virtualization/recipes-extended/container-bundles/"
BBMASK += "meta-virtualization/recipes-extended/container-cross-deploy/"

# ---------------------------------------------------------------------------
# Not in dependency graph (rootless/overlay helpers not RDEPENDS)
# ---------------------------------------------------------------------------
BBMASK += "meta-virtualization/recipes-extended/fuse-overlayfs/"
BBMASK += "meta-virtualization/recipes-extended/rootlesskit/"

# ---------------------------------------------------------------------------
# Container orchestration / tools not in vruntime
# ---------------------------------------------------------------------------
BBMASK += "meta-virtualization/recipes-containers/kubernetes/"
BBMASK += "meta-virtualization/recipes-containers/k3s/"
BBMASK += "meta-virtualization/recipes-containers/cri-o/"
BBMASK += "meta-virtualization/recipes-containers/cri-tools/"
BBMASK += "meta-virtualization/recipes-containers/docker-compose/"
BBMASK += "meta-virtualization/recipes-containers/podman-compose/"
BBMASK += "meta-virtualization/recipes-containers/podman-tui/"
BBMASK += "meta-virtualization/recipes-containers/nerdctl/"
BBMASK += "meta-virtualization/recipes-containers/buildah/"
BBMASK += "meta-virtualization/recipes-containers/singularity/"
BBMASK += "meta-virtualization/recipes-containers/lxc/"
BBMASK += "meta-virtualization/recipes-containers/lxcfs/"
BBMASK += "meta-virtualization/recipes-containers/criu/"
BBMASK += "meta-virtualization/recipes-containers/docker-distribution/"

# ---------------------------------------------------------------------------
# Container tooling not used by vdkr/vpdmn
# ---------------------------------------------------------------------------
BBMASK += "meta-virtualization/recipes-containers/cgroup-lite/"
BBMASK += "meta-virtualization/recipes-containers/riddler/"
BBMASK += "meta-virtualization/recipes-containers/umoci/"
BBMASK += "meta-virtualization/recipes-containers/sloci-image/"
BBMASK += "meta-virtualization/recipes-containers/oci-image-tools/"
BBMASK += "meta-virtualization/recipes-containers/oci-runtime-spec/"
BBMASK += "meta-virtualization/recipes-containers/oci-runtime-tools/"
BBMASK += "meta-virtualization/recipes-containers/oci-systemd-hook/"
BBMASK += "meta-virtualization/recipes-containers/oci-image-spec/"
BBMASK += "meta-virtualization/recipes-containers/oci-base-images/"
BBMASK += "meta-virtualization/recipes-containers/container-registry/"
BBMASK += "meta-virtualization/recipes-containers/go-digest/"
BBMASK += "meta-virtualization/recipes-containers/go-errors/"
BBMASK += "meta-virtualization/recipes-containers/go-spf13-cobra/"
BBMASK += "meta-virtualization/recipes-containers/go-spf13-pflag/"

# ---------------------------------------------------------------------------
# Other categories not needed
# ---------------------------------------------------------------------------
BBMASK += "meta-virtualization/recipes-demo/"
BBMASK += "meta-virtualization/recipes-graphics/"
BBMASK += "meta-virtualization/recipes-core/kata-containers/"
BBMASK += "meta-virtualization/recipes-core/runx/"
BBMASK += "meta-virtualization/recipes-networking/openvswitch/"
BBMASK += "meta-virtualization/recipes-networking/netns/"
BBMASK += "meta-virtualization/recipes-networking/passt/"

# ---------------------------------------------------------------------------
# Dev recipes not needed (keep qemu & yajl bbappends, keep linux bbappends)
# ---------------------------------------------------------------------------
BBMASK += "meta-virtualization/recipes-devtools/python/"
BBMASK += "meta-virtualization/recipes-devtools/go-dirhash-native/"
BBMASK += "meta-virtualization/recipes-devtools/yq/"
BBMASK += "meta-virtualization/recipes-kernel/lopper/"

# Individual go libraries not needed by vruntime builds
BBMASK += "meta-virtualization/recipes-devtools/go/go-connections"
BBMASK += "meta-virtualization/recipes-devtools/go/go-capability"
BBMASK += "meta-virtualization/recipes-devtools/go/go-build"
BBMASK += "meta-virtualization/recipes-devtools/go/compose-file"
BBMASK += "meta-virtualization/recipes-devtools/go/go-cli"
BBMASK += "meta-virtualization/recipes-devtools/go/go-context"
BBMASK += "meta-virtualization/recipes-devtools/go/go-logrus"
BBMASK += "meta-virtualization/recipes-devtools/go/go-libtrust"
BBMASK += "meta-virtualization/recipes-devtools/go/go-patricia"
BBMASK += "meta-virtualization/recipes-devtools/go/go-systemd"
BBMASK += "meta-virtualization/recipes-devtools/go/go-pty"
BBMASK += "meta-virtualization/recipes-devtools/go/go-dbus"
BBMASK += "meta-virtualization/recipes-devtools/go/go-distribution"
BBMASK += "meta-virtualization/recipes-devtools/go/go-metalinter"
BBMASK += "meta-virtualization/recipes-devtools/go/go-mux"
BBMASK += "meta-virtualization/recipes-devtools/go/grpc-go"
BBMASK += "meta-virtualization/recipes-devtools/go/go-fsnotify"
# go-md2man KEPT (crun, conmon DEPENDS on go-md2man-native)

# ---------------------------------------------------------------------------
# Orphaned bbappends in other layers (base recipes masked above)
# ---------------------------------------------------------------------------
BBMASK += "meta-openstack/recipes-extended/libvirt/"
```

## conf/distro/vcontainer.conf
```bitbake
# SPDX-FileCopyrightText: Copyright (C) 2025 Bruce Ashfield
#
# SPDX-License-Identifier: MIT
#
# VContainer - OCI container image builder distro
#
# Shares the same stripped DISTRO_FEATURES as vruntime (via vruntime-base.inc)
# but uses a lighter BBMASK that keeps OCI tooling available while still
# masking irrelevant recipes (graphics, multimedia, virtualization platforms,
# orchestration tools).
#
# Used by container-aarch64 / container-x86-64 multiconfigs to build
# single-arch OCI images that are then combined into multi-arch indexes.

require conf/distro/include/vruntime-base.inc

# Lighter BBMASK than vruntime: masks graphics, multimedia, desktop,
# virtualization platforms, and orchestration tools, but keeps OCI tooling
# (umoci, container-registry, image recipes) that vruntime blocks.
require conf/distro/include/vcontainer-bbmask.inc

DISTRO = "vcontainer"
DISTRO_NAME = "VContainer OCI Builder"
DISTRO_VERSION = "1.0"

# IMAGE_FSTYPES is NOT set here -- the 'oci' type requires image-oci.bbclass
# which only container image recipes inherit. Setting it distro-wide would
# break non-container images (e.g., core-image-*) parsed in this distro.
# Container recipes like container-base.bb set their own IMAGE_FSTYPES.
```

## conf/machine/a10socdk.conf
```bitbake
#@TYPE: Machine
#@NAME: Arria 10 SoC Development kit machine
#@DESCRIPTION: Machine configuration for the https://www.terasic.com.tw/cgi-bin/page/archive.pl?Language=English&CategoryNo=228&No=997 board 

DEFAULTTUNE = "cortexa9thf-neon"
require conf/machine/arria10.conf
MACHINEOVERRIDES =. "arria10:"

UBOOT_CONFIG = "arria10-socdk"
UBOOT_EXTLINUX = "0"

# IMAGE_FSTYPES = "tar wic wic.bmap"
IMAGE_FSTYPES = "tar"

IMAGE_BOOT_FILES_remove = "extlinux.conf;extlinux/extlinux.conf"
IMAGE_BOOT_FILES_append = "uEnv.txt"

MACHINE_ESSENTIAL_EXTRA_RRECOMMENDS_append = " kernel-modules"
```

## conf/machine/agilex7_dk_dev_agf023fa.conf
```bitbake
#@TYPE: Machine
#@NAME: Altera SoCFPGA Agilex7 DK-SI-AGF014EB (LINEAR)
#@DESCRIPTION: Machine configuration for the Agilex7 DK-SI-AGF014EB (LINEAR) SoCFPGA

require conf/machine/include/socfpga_armv8a.inc
require conf/machine/include/ubifs.inc

KBUILD_DEFCONFIG ?= "defconfig"

UBOOT_CONFIG ??= "agilex-socdk-atf"
UBOOT_CONFIG[agilex-socdk] = "socfpga_agilex_legacy_defconfig"
UBOOT_CONFIG[agilex-socdk-atf] = "socfpga_agilex_defconfig"
UBOOT_CONFIG[agilex-socdk-qspi] = "socfpga_agilex_qspi_legacy_defconfig"
UBOOT_CONFIG[agilex-socdk-qspi-atf] = "socfpga_agilex_defconfig"

UBOOT_BINARY = "u-boot.itb"
UBOOT_SUFFIX = "itb"

KERNEL_CLASSES:append = " kernel-fitimage"
KERNEL_IMAGETYPE = "Image"

KERNEL_DEVICETREE ?= "intel/socfpga_agilex_socdk.dtb"
UBOOT_ENTRYPOINT = "0x4000000"
UBOOT_LOADADDRESS = "0x4000000"
FIT_KERNEL_COMP_ALG = "none"

SERIAL_CONSOLES ?= "115200;ttyS0"

EXTRA_IMAGECMD:jffs2 ?= "-n -q -e 0x10000"

UBOOT_EXTLINUX ?= "1"
UBOOT_EXTLINUX_LABELS ?= "default"
UBOOT_EXTLINUX_DEFAULT_LABEL ?= "Agilex SOCDK SDMMC"

UBOOT_EXTLINUX_MENU_DESCRIPTION:default ?= "Agilex SOCDK SDMMC"
UBOOT_EXTLINUX_KERNEL_IMAGE:default ?= "../${KERNEL_IMAGETYPE}"
UBOOT_EXTLINUX_FDTDIR:default ?= ".."
UBOOT_EXTLINUX_CONSOLE ?= "console=ttyS0,115200n8"
UBOOT_EXTLINUX_KERNEL_ARGS:default ?= "rootwait rw earlyprintk"
UBOOT_EXTLINUX_ROOT:default ?= "root=/dev/mmcblk0p2"

# Add variables for wic creation of sdcard image
IMAGE_BOOT_FILES ?= " \
			${UBOOT_BINARY} \
			Image \
			socfpga_agilex_socdk.dtb \
		    "

WKS_FILE ?= "sdimage-stratix10-agilex.wks"
IMAGE_FSTYPES:append = " wic"
```

## conf/machine/agilex7_dk_si_agi027fa.conf
```bitbake
#@TYPE: Machine
#@NAME: Intel SoCFPGA Agilex7 DK-SI-AGI027FA (LINEAR)
#@DESCRIPTION: Machine configuration for the Agilex7 DK-SI-AGI027FA (LINEAR) SoCFPGA

require conf/machine/agilex7_dk_si_agf014ea.conf
require conf/machine/include/ubifs.inc

UBOOT_CONFIG ??= "agilex7_dk_si_agi027fb-socdk-atf"
UBOOT_CONFIG[agilex7_dk_si_agi027fb-socdk] = "socfpga_agilex_legacy_defconfig"
UBOOT_CONFIG[agilex7_dk_si_agi027fb-socdk-atf] = "socfpga_agilex_defconfig"
UBOOT_CONFIG[agilex7_dk_si_agi027fb-socdk-qspi] = "socfpga_agilex_qspi_legacy_defconfig"
UBOOT_CONFIG[agilex7_dk_si_agi027fb-socdk-qspi-atf] = "socfpga_agilex_defconfig"
```

## conf/machine/arria10-daq.conf
```bitbake
#@TYPE: Machine
#@NAME: Arria 10 daq machine
#@DESCRIPTION: Machine configuration for the Arria10-daq board 

DEFAULTTUNE = "cortexa9thf-neon"
require include/arria10.conf
MACHINEOVERRIDES =. "arria10:"

UBOOT_CONFIG[arria10-daq] = "socfpga_daq_defconfig"
UBOOT_CONFIG = "arria10-daq"
UBOOT_EXTLINUX = "0"
KERNEL_DEVICETREE:append ?= "\
			socfpga_arria10_daq_sdmmc.dtb \
			"

PRIMARY_NETIF = "eth0"
ROOT = "root=/dev/mmcblk0p3"
ROOTUSB = "root=/dev/sda3"
WKS_FILE = "sdimage-arria10.wks"

IMAGE_FSTYPES = "tar wic wic.bmap"

IMAGE_BOOT_FILES:remove = "extlinux.conf;extlinux/extlinux.conf"
IMAGE_BOOT_FILES:append = "boot.scr.uimg uEnv.txt fit_spl_fpga.itb"

MACHINE_EXTRA_RRECOMMENDS:append = " kernel-modules mtd-utils"

OPENBLAS_TARGET = "CORTEXA9"
```

## conf/machine/arria10.conf
```bitbake
#@TYPE: Machine
#@NAME: Intel SoCFPGA Arria10
#@DESCRIPTION: Machine configuration for the Arria 10 SoCFPGA

require conf/machine/include/socfpga.inc

SPL_BINARY = "spl/u-boot-splx4.sfp"
UBOOT_BINARY = "u-boot.img"

UBOOT_CONFIG ??= "arria10-socdk"
UBOOT_CONFIG[arria10-socdk] = "socfpga_arria10_defconfig"
UBOOT_CONFIG[arria10-socdk-nand] = "socfpga_arria10_nand_defconfig"
UBOOT_CONFIG[arria10-socdk-qspi] = "socfpga_arria10_qspi_defconfig"

KMACHINE = "arria10"

# Default kernel devicetrees
KERNEL_DEVICETREE ?= "\
			socfpga_arria10_socdk_sdmmc.dtb \
			socfpga_arria10_socdk_qspi.dtb \
			socfpga_arria10_socdk_nand.dtb \
			"

EXTRA_IMAGECMD:jffs2 ?= "-n -q \
	${@bb.utils.contains("IMAGE_TYPE", "nand", "-e 0x20000 -s 0x200", "", d)} \
	${@bb.utils.contains("IMAGE_TYPE", "qspi", "-e 0x10000", "", d)} \
	"

SERIAL_CONSOLES ?= "115200;ttyS0"

UBOOT_EXTLINUX ?= "1"
UBOOT_EXTLINUX_LABELS ?= "default"
UBOOT_EXTLINUX_DEFAULT_LABEL ?= "Arria10 SOCDK SDMMC"

UBOOT_EXTLINUX_MENU_DESCRIPTION:default ?= "Arria10 SOCDK SDMMC"
UBOOT_EXTLINUX_KERNEL_IMAGE:default ?= "../${KERNEL_IMAGETYPE}"
UBOOT_EXTLINUX_FDTDIR:default ?= ".."
UBOOT_EXTLINUX_CONSOLE ?= "console=ttyS0,115200n8"
UBOOT_EXTLINUX_KERNEL_ARGS:default ?= "rootwait rw earlyprintk memmap=16M$0x3F000000"
UBOOT_EXTLINUX_ROOT:default ?= "root=/dev/mmcblk0p2"

IMAGE_BOOT_FILES ?= " \
	${KERNEL_DEVICETREE} \
	${KERNEL_IMAGETYPE} \
	${UBOOT_BINARY} \
	extlinux.conf;extlinux/extlinux.conf \
        "

# Build both Image and zImage for Arria10
KERNEL_ALT_IMAGETYPE = "Image"

WKS_FILE ?= "sdimage-arria10.wks"
IMAGE_FSTYPES:append = " wic"
```

## conf/machine/beaglebone.conf
```bitbake
#@TYPE: Machine
#@NAME: BeagleBone machine
#@DESCRIPTION: Machine configuration for the http://beagleboard.org/bone board

DEFAULTTUNE = "cortexa8hf-neon"
require include/ti33x.inc

KERNEL_DEVICETREE = "am335x-bone.dtb am335x-boneblue.dtb \
                    am335x-boneblack.dtb am335x-boneblack-wireless.dtb \
                    am335x-bonegreen.dtb am335x-bonegreen-wireless.dtb"

# Only has DVI connector for external screen
MACHINE_GUI_CLASS = "bigscreen"

SERIAL_CONSOLES = "115200;ttyS0"
PRIMARY_NETIF = "eth0"
ROOT = "root=/dev/mmcblk0p2"
ROOTUSB = "root=/dev/sda2"
WKS_FILE = "sdimage-2part.wks.in"

IMAGE_BOOT_FILES = "${SPL_BINARY} u-boot.${UBOOT_SUFFIX} boot.scr.uimg"

IMAGE_FSTYPES = "tar wic wic.bmap"

MACHINE_ESSENTIAL_EXTRA_RDEPENDS_append = " kernel-devicetree kernel-image-zimage"

# Refine the list of device targets for ti-pdk class recipes
TI_PDK_LIMIT_BOARDS = "bbbAM335x"

MACHINE_ESSENTIAL_EXTRA_RRECOMMENDS_append = " kernel-modules u-boot-ti-staging-mmc1 wl18xx-fw"
```
