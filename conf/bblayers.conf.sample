## conf/machine/beagleboneai.conf
```bitbake
#@TYPE: Machine
#@NAME: BeagleBone AI machine
#@DESCRIPTION: Machine configuration for the http://beagleboard.org/boneai board

DEFAULTTUNE = "cortexa15hf-neon-vfpv4"
require conf/machine/include/dra7xx.inc

UBOOT_MACHINE = "am57xx_evm_config"

KERNEL_DEVICETREE = " \
    am5729-beagleboneai.dtb \
"

# Only has DVI connector for external screen
MACHINE_GUI_CLASS = "bigscreen"

SERIAL_CONSOLES = "115200;ttyS2"
PRIMARY_NETIF = "eth0"
ROOT = "root=/dev/mmcblk0p2"
ROOTUSB = "root=/dev/sda2"
WKS_FILE = "sdimage-2part.wks.in"

IMAGE_BOOT_FILES = "${SPL_BINARY} u-boot.${UBOOT_SUFFIX} boot.scr.uimg"

IMAGE_FSTYPES = "tar wic wic.bmap"

MACHINE_ESSENTIAL_EXTRA_RDEPENDS_append = " kernel-devicetree kernel-image-zimage"

# Refine the list of device targets for ti-pdk class recipes
TI_PDK_LIMIT_SOCS = "am572x"
TI_PDK_LIMIT_BOARDS = "evmAM572x idkAM572x"

MACHINE_ESSENTIAL_EXTRA_RRECOMMENDS_append = " kernel-modules u-boot-ti-staging-mmc1"
```

## conf/machine/cyclone5.conf
```bitbake
#@TYPE: Machine
#@NAME: cyclone5
#@DESCRIPTION: Machine configuration for the Cyclone V SoC" 

require conf/machine/include/socfpga.inc

UBOOT_CONFIG ??= "cyclone5-socdk"
UBOOT_CONFIG[cyclone5-socdk] = "socfpga_cyclone5_defconfig"
UBOOT_CONFIG[de0-nano-soc] = "socfpga_de0_nano_soc_defconfig"
UBOOT_CONFIG[de10-nano-soc] = "socfpga_de10_nano_defconfig"
UBOOT_CONFIG[mcvevk] = "socfpga_mcvevk_defconfig"
UBOOT_CONFIG[sockit] = "socfpga_sockit_defconfig"
UBOOT_CONFIG[socrates] = "socfpga_socrates_defconfig"
UBOOT_CONFIG[sr1500] = "socfpga_sr1500_defconfig"

KMACHINE = "cyclone5"

# Default kernel devicetrees
KERNEL_DEVICETREE ?= "\
			socfpga_cyclone5_socdk.dtb \
			socfpga_cyclone5_sockit.dtb \
			socfpga_cyclone5_socrates.dtb \
			socfpga_cyclone5_de0_nano_soc.dtb \
			socfpga_cyclone5_mcvevk.dtb \
			socfpga_cyclone5_sodia.dtb \
			socfpga_cyclone5_vining_fpga.dtb \
			"

SERIAL_CONSOLES ?= "115200;ttyS0"

UBOOT_EXTLINUX ?= "1"
UBOOT_EXTLINUX_LABELS ?= "default"
UBOOT_EXTLINUX_DEFAULT_LABEL ?= "Cyclone5 SOCDK SDMMC"

UBOOT_EXTLINUX_CONSOLE ?= "console=ttyS0,115200n8"
UBOOT_EXTLINUX_ROOT:default ?= "root=/dev/mmcblk0p2"
UBOOT_EXTLINUX_MENU_DESCRIPTION:default ?= "Cyclone5 SOCDK SDMMC"
UBOOT_EXTLINUX_KERNEL_IMAGE:default ?= "../${KERNEL_IMAGETYPE}"
UBOOT_EXTLINUX_FDTDIR:default ?= ".."
UBOOT_EXTLINUX_KERNEL_ARGS:default ?= "rootwait rw earlyprintk"

EXTRA_IMAGECMD:jffs2 ?= "-e 0x10000"

IMAGE_BOOT_FILES ?= " \
	${KERNEL_DEVICETREE} \
	${KERNEL_IMAGETYPE} \
	extlinux.conf;extlinux/extlinux.conf \
	"

WKS_FILE ?= "sdimage-cyclone5-arria5.wks"
IMAGE_FSTYPES:append = " wic"
```

## conf/machine/d-6244-x11dph-t.conf
```bitbake
#@TYPE: Machine
#@NAME: d-6244-x11dph-t
#@DESCRIPTION: Machine configuration for a dual-socket 6244 Intel processor on Supermicro X11DPH-T motherboard (64-bit)

require include/intel-common.inc
require include/tune-cascadelake.inc

MACHINEOVERRIDES =. "d-6244:x11dph-t:"

IMAGE_FSTYPES = "tar"

PRIMARY_NETIF = "eno1"
ROOT = "/dev/sda2"

EXTRA_IMAGEDEPENDS += "grub-efi grub-bootconf"

WKS_FILE = "grub-bootdisk-microcode.wks.in"

MACHINE_ESSENTIAL_EXTRA_RRECOMMENDS_remove = "linux-firmware"
MACHINE_ESSENTIAL_EXTRA_RRECOMMENDS_append = " numactl"
```

## conf/machine/d-6346-06v45n.conf
```bitbake
#@TYPE: Machine
#@NAME: d-6346-06v45n
#@DESCRIPTION: Machine configuration for a dual-socket 6346 Intel processor on DELL 06v45n motherboard (64-bit)

require include/intel-common.inc
require include/tune-icelake-server.inc

MACHINEOVERRIDES =. "d-6346:06v45n:"

IMAGE_FSTYPES = "tar"

PRIMARY_NETIF = "eno8303"
ROOT = "/dev/sda2"

EXTRA_IMAGEDEPENDS += "grub-efi grub-bootconf"

WKS_FILE = "grub-bootdisk-microcode.wks.in"

MACHINE_ESSENTIAL_EXTRA_RRECOMMENDS_remove = "linux-firmware"
```

## conf/machine/d-e52637v3-x10drw-i.conf
```bitbake
#@TYPE: Machine
#@NAME: d-e52637v3-x10drw-i
#@DESCRIPTION: Machine configuration for a dual-socket E5 2637v3 Intel processor on Supermicro X10DRW-i motherboard (64-bit)

require include/intel-common.inc
require include/tune-haswell.inc

MACHINEOVERRIDES =. "d-e52637v3:x10drw-i:"

IMAGE_FSTYPES = "tar"

PRIMARY_NETIF = "eno1"
ROOT = "/dev/sda2"

EXTRA_IMAGEDEPENDS += "grub-efi grub-bootconf"
PREFERRED_PROVIDER_virtual/bootloader = "grub-efi"

MACHINE_EXTRA_RRECOMMENDS:remove = "linux-firmware"
MACHINE_EXTRA_RRECOMMENDS:append = " bios intel-ethernet-550-firmware \
	intel-ethernet-700-firmware intel-ethernet-810-firmware"

OPENBLAS_TARGET = "HASWELL"

COMPATIBLE_MACHINE:pn-dpdk = "d-e52637v3-x10drw-i"
COMPATIBLE_MACHINE:pn-nativesdk-dpdk = "(.*)"
```

## conf/machine/d-e52637v4-x10dru-iplus.conf
```bitbake
#@TYPE: Machine
#@NAME: d-e52637v4-x10dru-i+
#@DESCRIPTION: Machine configuration for a dual-socket E5 2637v4 Intel processor on Supermicro X10DRU-i+ motherboard (64-bit)

require include/intel-common.inc
require include/tune-broadwell.inc

MACHINEOVERRIDES =. "d-e52637v4:x10dru-iplus:"

IMAGE_FSTYPES = "tar"

PRIMARY_NETIF = "enp1s0f0"
ROOT = "/dev/sda2"

EXTRA_IMAGEDEPENDS += "grub-efi grub-bootconf"
PREFERRED_PROVIDER_virtual/bootloader = "grub-efi"

MACHINE_EXTRA_RRECOMMENDS:remove = "linux-firmware"
MACHINE_EXTRA_RRECOMMENDS:append = " bios intel-ethernet-550-firmware \
	intel-ethernet-700-firmware intel-ethernet-810-firmware"

OPENBLAS_TARGET = "HASWELL"

COMPATIBLE_MACHINE:pn-dpdk = "d-e52637v4-x10dru-iplus"
COMPATIBLE_MACHINE:pn-nativesdk-dpdk = "(.*)"
```

## conf/machine/d-e52643v4-x10dru-iplus.conf
```bitbake
#@TYPE: Machine
#@NAME: d-e52643v4-x10dru-i+
#@DESCRIPTION: Machine configuration for a dual-socket E5 2643v4 Intel processor on Supermicro X10DRU-i+ motherboard (64-bit)

require include/intel-common.inc
require include/tune-broadwell.inc

MACHINEOVERRIDES =. "d-e52643v4:x10dru-iplus:"

IMAGE_FSTYPES = "tar"

PRIMARY_NETIF = "eth0"
ROOT = "/dev/sda2"

EXTRA_IMAGEDEPENDS += "grub-efi"
PREFERRED_PROVIDER_virtual/bootloader = "grub-efi"

MACHINE_EXTRA_RRECOMMENDS:remove = "linux-firmware"
# bios
MACHINE_EXTRA_RRECOMMENDS:append = " intel-ethernet-700-firmware"

OPENBLAS_TARGET = "HASWELL"

COMPATIBLE_MACHINE:pn-dpdk = "d-e52643v4-x10dru-iplus"
COMPATIBLE_MACHINE:pn-nativesdk-dpdk = "(.*)"
```

## conf/machine/d-e5462-x7dwu.conf
```bitbake
#@TYPE: Machine
#@NAME: d-e5462-x7dwu
#@DESCRIPTION: Machine configuration for a dual-socket E5462 Intel processor on Supermicro X7DWU motherboard (64-bit)

require include/intel-common.inc
require include/tune-penryn.inc

MACHINEOVERRIDES =. "d-e5462:x7dwu:"

IMAGE_FSTYPES = "tar"

PRIMARY_NETIF = "enp8s0f0"
ROOT = "/dev/sda2"

EXTRA_IMAGEDEPENDS += "grub-pxe grub-bootconf"
PREFERRED_PROVIDER_virtual/bootloader = "grub-pxe"

MACHINE_EXTRA_RRECOMMENDS:remove = "linux-firmware"
MACHINE_EXTRA_RRECOMMENDS:append = " bios intel-ethernet-550-firmware \
	intel-ethernet-700-firmware intel-ethernet-810-firmware"

OPENBLAS_TARGET = "PENRYN"

COMPATIBLE_MACHINE:pn-dpdk = "d-e5462-x7dwu"
COMPATIBLE_MACHINE:pn-nativesdk-dpdk = "(.*)"
```
