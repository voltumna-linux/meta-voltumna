## meta-amd-distro/conf/distro/poky-amd.conf
```bitbake
require conf/distro/poky.conf

DISTRO = "poky-amd"
DISTRO_NAME = "Poky for AMD"
DISTROOVERRIDES = "${DISTRO}"
TARGET_VENDOR = "-amd"
SDK_VENDOR = "-amdsdk"
MAINTAINER = "Rahul Kumar <rahul.kumar1@amd.com>"

INIT_MANAGER = "systemd"

EXTRA_IMAGE_FEATURES:append = " package-management ssh-server-openssh"
PACKAGE_CLASSES = "package_deb"

DISTRO_EXTRA_RDEPENDS += "connman udev-extraconf"

IMAGE_ROOTFS_EXTRA_SPACE = "51200"

# We want information about package and image contents
INHERIT += "buildhistory"
BUILDHISTORY_COMMIT ?= "1"

# We only support IMAGE_FSTYPES "wic" and "iso"
IMAGE_FSTYPES = "wic wic.bmap iso"

WKS_FILES ?= "amd-usbimage.wks"

# Contents of IMAGE_BOOT_FILES are deployed into "amd-usbimage.wks" wic image
IMAGE_BOOT_FILES = " \
        ${EFIIMGDIR}${EFIDIR}/*;EFI/BOOT/ \
        ${EFIIMGDIR}/startup.nsh;startup.nsh \
        ${KERNEL_IMAGETYPE} \
        ${INITRD_IMAGE_LIVE}-${MACHINE}.cpio.gz;initrd \
        ${ROOTFS};rootfs.img \
"

# This makes sure that boot files are deployed before do_image_wic starts execution
do_image_wic[depends] += "${IMAGE_BASENAME}:do_bootimg"

IMAGE_OVERHEAD_FACTOR = "1.1"

# Exclude complementary (-src,-dbg & -dev) pkgs of the following
# recipes as they are not required while populate_sdk, and they fail
# to get installed due to missing dependencies, therefore generate a
# warning and even the rest of the complementary pkgs in the list
# don't get installed when using debian based package-managemant.
PACKAGE_EXCLUDE_COMPLEMENTARY = "dpkg|autoconf|automake|packagegroup-core-buildessential|packagegroup-core-sdk|packagegroup-core-tools-profile|perf|quilt|systemtap|target-sdk-provides-dummy"

# "apt" is an exception to the above PACKAGE_EXCLUDE_COMPLEMENTARY list
# as oe uses apt itself to install/remove/exclude the above-listed
# complementary pkgs, and when apt is listed in the above-listed
# PACKAGE_EXCLUDE_COMPLEMENTARY, it tries to removes itself, and it
# asks for user input and oe gets out of there and our complementary
# pkgs don't get installed, but they are required for development and
# debugging purposes using the SDK.
TOOLCHAIN_TARGET_TASK:remove = " apt"
```

## meta-amd/meta-amd-bsp/conf/layer.conf
```bitbake
BBPATH .= ":${LAYERDIR}"
BBFILES += "${LAYERDIR}/recipes*/*/*.bb \
            ${LAYERDIR}/recipes*/*/*.bbappend"

# Let us add layer-specific bbs & bbappends which are only applied
# when that layer is included in our configuration
BBFILES += "${@' '.join('${LAYERDIR}/%s/recipes*/*/*.bb' % layer \
               for layer in BBFILE_COLLECTIONS.split())} \
            ${@' '.join('${LAYERDIR}/%s/recipes*/*/*.bbappend' % layer \
               for layer in BBFILE_COLLECTIONS.split())}"

BBFILE_COLLECTIONS += "amd-bsp"
BBFILE_PRIORITY_amd-bsp = "13"
BBFILE_PATTERN_amd-bsp = "^${LAYERDIR}/"
LAYERSERIES_COMPAT_amd-bsp = "kirkstone scarthgap whinlatter"

LAYERDEPENDS_amd-bsp = "core openembedded-layer meta-python networking-layer"
```

## meta-amd/meta-amd-bsp/conf/machine/common.conf
```bitbake
IMAGE_FSTYPES = "wic wic.bmap iso"
WKS_FILES ?= "amd-usbimage.wks"

# Contents of IMAGE_BOOT_FILES are deployed into "amd-usbimage.wks" wic image
IMAGE_BOOT_FILES = " \
        ${EFIIMGDIR}${EFIDIR}/*;EFI/BOOT/ \
        ${EFIIMGDIR}/startup.nsh;startup.nsh \
        ${KERNEL_IMAGETYPE} \
        ${INITRD_IMAGE_LIVE}-${MACHINE}.cpio.gz;initrd \
        ${ROOTFS};rootfs.img \
"

# This makes sure that boot files are deployed before do_image_wic starts execution
do_image_wic[depends] += "${IMAGE_BASENAME}:do_bootimg"


IMAGE_TYPEDEP_wic = "ext4"
INITRD_IMAGE_LIVE="core-image-minimal-initramfs"
LABELS_LIVE = "boot install"
EFI_PROVIDER = "grub-efi"
do_image_wic[depends] += "${INITRD_IMAGE_LIVE}:do_image_complete"
do_rootfs[depends] += "virtual/kernel:do_deploy"
IMAGE_BOOT_FILES:append = "\
      ${KERNEL_IMAGETYPE} \
      ${IMGDEPLOYDIR}/${IMAGE_BASENAME}-${MACHINE}.rootfs.ext4;rootfs.img \
      ${@bb.utils.contains('EFI_PROVIDER', 'grub-efi', 'grub-efi-bootx64.efi;EFI/BOOT/bootx64.efi', '', d)} \
      ${@bb.utils.contains('EFI_PROVIDER', 'grub-efi', '${IMAGE_ROOTFS}/boot/EFI/BOOT/grub.cfg;EFI/BOOT/grub.cfg', '', d)} \
      ${@bb.utils.contains('EFI_PROVIDER', 'systemd-boot', 'systemd-bootx64.efi;EFI/BOOT/bootx64.efi', '', d)} \
      ${@bb.utils.contains('EFI_PROVIDER', 'systemd-boot', '${IMAGE_ROOTFS}/boot/loader/loader.conf;loader/loader.conf ', '', d)} \
      ${@bb.utils.contains('EFI_PROVIDER', 'systemd-boot', '${IMAGE_ROOTFS}/boot/loader/entries/boot.conf;loader/entries/boot.conf', '', d)} "

INIT_MANAGER = "systemd"
VIRTUAL-RUNTIME_init_manager = "systemd"
DISTRO_FEATURES_BACKFILL_CONSIDERED = "sysvinit"
MACHINE_FEATURES_NATIVE:append = " efi"
MACHINE_FEATURES:append = " efi"
MACHINE_FEATURES:append = " pcbios util-linux-blkid"
IMAGE_INSTALL:append = " grub grub-efi grub-bootconf"
CORE_IMAGE_EXTRA_INSTALL:append = " kernel-modules"
```
