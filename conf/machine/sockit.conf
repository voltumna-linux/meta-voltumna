## conf/machine/sockit.conf
```bitbake
#@TYPE: Machine
#@NAME: Sockit machine
#@DESCRIPTION: Machine configuration for the http://sockit.terasic.com board 

DEFAULTTUNE = "cortexa9hf-neon"
require conf/machine/cyclone5.conf
MACHINEOVERRIDES =. "cyclone5:"

UBOOT_CONFIG = "sockit"
UBOOT_EXTLINUX = "0"

PRIMARY_NETIF = "eth0"
ROOT = "root=/dev/mmcblk0p3"
ROOTUSB = "root=/dev/sda3"
WKS_FILE = "sdimage-cyclone5-arria5.wks.in"

IMAGE_FSTYPES = "tar wic wic.bmap"

IMAGE_BOOT_FILES_remove = "extlinux.conf;extlinux/extlinux.conf"
IMAGE_BOOT_FILES_append = "boot.scr.uimg"

MACHINE_ESSENTIAL_EXTRA_RRECOMMENDS_append = " kernel-modules mtd-utils"
```

## conf/machine/ssg-6039p-e1cr16h.conf
```bitbake
#@TYPE: Machine
#@NAME: Customized Supermicro SSG-6039P-E1CR16H
#@DESCRIPTION: Machine configuration for customized Supermicro SSG-6039P-E1CR16H (64-bit)

require include/intel-common.inc
require include/tune-cascadelake.inc

IMAGE_FSTYPES = "tar"

PRIMARY_NETIF = "enp26s0f0"
ROOT = "/dev/sda2"

EXTRA_IMAGEDEPENDS += "grub-efi"

WKS_FILE = "grub-bootdisk-microcode.wks.in"

MACHINE_EXTRA_RRECOMMENDS_remove = "linux-firmware"
MACHINE_EXTRA_RRECOMMENDS_append = " bios intel-ethernet-700-firmware numactl"

OPENBLAS_TARGET = "SKYLAKEX"
```

## conf/machine/sys-5019p-wtr.conf
```bitbake
#@TYPE: Machine
#@NAME: Customized Supermicro SYS-5019P-WTR
#@DESCRIPTION: Machine configuration for customized Supermicro SYS-5019P-WTR (64-bit)

require include/intel-common.inc
require include/tune-cascadelake.inc

IMAGE_FSTYPES = "tar"

PRIMARY_NETIF = "enp26s0f0"
ROOT = "/dev/sda2"

EXTRA_IMAGEDEPENDS += "grub-efi"

WKS_FILE = "grub-bootdisk-microcode.wks.in"

MACHINE_EXTRA_RRECOMMENDS_remove = "linux-firmware"
MACHINE_EXTRA_RRECOMMENDS_append = " bios intel-ethernet-700-firmware numactl"

OPENBLAS_TARGET = "SKYLAKEX"
```

## conf/machine/up-whl01.conf
```bitbake
#@TYPE: Machine
#@NAME: UP-Board Xtreme Celeron 4305UE (UPX-WHLCR-A20-04064)
#@DESCRIPTION: Machine configuration for UP-Board Xtreme Celeron 4305UE UPX-WHLCR-A20-04064 (64-bit)

require include/intel-common.inc
require include/tune-skylake.inc

IMAGE_FSTYPES = "tar wic wic.bmap"

PRIMARY_NETIF = "enp1s0f0"
ROOT = "/dev/sda2"

EXTRA_IMAGEDEPENDS += "grub-efi"

WKS_FILE = "grub-bootdisk-microcode.wks.in"

MACHINE_EXTRA_RRECOMMENDS_remove = "linux-firmware"
#FIXME bios opencl-icd-loader opencl-clang
MACHINE_EXTRA_RRECOMMENDS_append = " intel-ethernet-700-firmware dpdk"

OPENBLAS_TARGET = "HASWELL"
```

## files/wic/grub-bootdisk.wks
```
part /boot --source bootimg-efi --sourceparams="loader=grub-efi,install-kernel-into-boot-dir=false" --ondisk sda --label boot --active --align 1024 --fixed-size 32M
part / --source rootfs --ondisk sda --fstype=ext4 --label root --align 1024
bootloader --ptable gpt --configfile="${DEPLOY_DIR_IMAGE}/grub-${IMAGE_LINK_NAME}.cfg"
```

## files/wic/sdimage-2part.wks
```
part /boot --source bootimg-partition --ondisk mmcblk0 --fstype=vfat --label boot --active --align 1024 --fixed-size 32M
part / --source rootfs --ondisk mmcblk0 --fstype=ext4 --label root --align 1024
bootloader --ptable msdos
```

## files/wic/sdimage-arria10.wks
```
part /boot --source bootimg-partition --ondisk mmcblk --fstype=vfat --label boot --active --align 1024 --fixed-size 32M --system-id b
part --source rawcopy --sourceparams="file=u-boot-splx4.sfp" --ondisk mmcblk --system-id=a2 --align 1024 --fixed-size 10M
part / --source rootfs --ondisk mmcblk --fstype=ext4 --label root --align 1024
bootloader --ptable msdos
```

## meta-amd-bsp/conf/machine/e2005.conf
```bitbake
#@TYPE: Machine
#@NAME: e2005

#@DESCRIPTION: Machine configuration for e2005 systems

require conf/machine/include/tune-zen3.inc
require conf/machine/include/vortex.inc

# Include common configuration
include conf/machine/common.conf
include conf/machine/kernel.conf
```

## meta-amd-bsp/conf/machine/e3000.conf
```bitbake
#@TYPE: Machine
#@NAME: e3000

#@DESCRIPTION: Machine configuration for e3000 systems

require conf/machine/include/tune-zen1.inc
require conf/machine/include/wallaby.inc

# Enable AMD Cryptographic Co-processor Encryption Controller drivers
MACHINE_FEATURES:append = " ccp"
```

## meta-amd-bsp/conf/machine/genoa.conf
```bitbake
#@TYPE: Machine
#@NAME: Genoa

#@DESCRIPTION: Machine configuration for Genoa systems

require conf/machine/include/tune-zen3.inc
require conf/machine/include/quartz.inc
```

## meta-amd-bsp/conf/machine/include/amd-common-configurations.inc
```bitbake
require conf/machine/include/amd-features.inc

POKY_DEFAULT_DISTRO_FEATURES:remove = "wayland"

PREFERRED_PROVIDER_jpeg ?= "jpeg"
PREFERRED_PROVIDER_jpeg-native ?= "jpeg-native"

MULTILIBS ?= ""
require conf/multilib.conf

MACHINE_FEATURES += "wifi efi alsa"

# QEMU does not support some of the enhanced instructions available
# on the AMD chips which causes some build time failures.
MACHINE_FEATURES:remove = "qemu-usermode"

MACHINE_EXTRA_RRECOMMENDS += "kernel-modules alsa-utils"
MACHINE_EXTRA_RRECOMMENDS += "grub parted util-linux-blkid"
MACHINE_EXTRA_RRECOMMENDS += "rtc-test watchdog-test smbus-test gpio-test"

# Add serial consoles to kernel commandline, these should occur before the tty0
KERNEL_SERIAL_CONSOLE ??= ""
APPEND += "${KERNEL_SERIAL_CONSOLE}"

# Make sure the kernel messages go to the VGA console
APPEND += "console=tty0"

# Set a generic video mode, use gfxpayload=wxh for grub2
GRUB_OPTS:append = ";set gfxpayload=1024x768"

# We use ext4 rootfs normally so give it priority rather than trying other FS first
APPEND += "rootfstype=ext4,ext3,ext2"

APPEND_ADDITIONAL ??= ""
APPEND += "${APPEND_ADDITIONAL}"

EXTRA_OECONF:append:pn-matchbox-panel-2 = " --with-battery=acpi"

# Add common feartures to be supported for all machines here
EXTRA_IMAGE_FEATURES += "amd-misc-pkgs"
```

## meta-amd-bsp/conf/machine/include/amd-features.inc
```bitbake
# This file defines AMD Features that can be added as EXTRA_IMAGE_FEATURES to
# different machines based on what is supported on a machine (MACHINE_FEATURES)
# and which additional features a user is requesting through EXTRA_IMAGE_FEATURES.
# This gives a broad flexibility and control over packages being installed on a
# machine for any image without needing to create bbappends for all the images
# that are to be supported.
#
# > Each feature can contain packages and packagegroups as its components.
# > Feature components can be dependent on DISTRO, EXTRA_IMAGE_FEATURES, or any
#   variable in general other than a particular image's related variable so most
#   things should be based on global configs rather than image configs.
#   e.g.: Components of "amd-feature-graphics" may be dependent on "x11-base" as
#   an IMAGE_FEATURE. Some packages may only be included for a specific
#   DISTRO. Some packages may only be installed if user allows them in local.conf etc.
# > Each machine must add the requested features to EXTRA_IMAGE_FEATURES in its
#   own machine config file regardless of the image being built, if that particular
#   feature is not handled in the common fragments.
# > Each machine can also override feature components in its own machine config 
#   when adding the feature to EXTRA_IMAGE_FEATURES. e.g.: A feature may be added
#   to a specific machine with minimal (or extended) packages based on requirement.
#
# Features are classified as:
#
# * amd-misc-pkgs		: Intended for Platform Specific Packages, Common Packages to be added to all machines, etc.
# * amd-feature-multimedia	: Multimedia packages (it does not depend on graphics because a machine may not have a GUI but could play videos and sounds from console)
# * amd-feature-graphics	: Graphics packages
# * amd-feature-networking	: Networking packages
# * amd-feature-debug-profile	: Debugging and Profiling tools
# * <add more features here>	: <feature summary>

GSTREAMER_PKGS ?= " \
    ${@bb.utils.contains("IMAGE_FEATURES", "x11-base", "gstreamer1.0-meta-x11-base", "", d)} \
    ${@bb.utils.contains("COMBINED_FEATURES", "alsa", "gstreamer1.0-meta-audio", "", d)} \
    gstreamer1.0-meta-debug \
    gstreamer1.0-meta-video \
    ${@bb.utils.contains("IMAGE_FEATURES", "x11-base", "gstreamer1.0-omx", "", d)} \
    ${@bb.utils.contains("IMAGE_FEATURES", "x11-base", "gstreamer1.0-vaapi", "", d)} \
"
VULKAN_PKGS ?= ""
CODEXL_PKGS ?= ""
DPDK_PKGS ?= ""

# Additional packages can be added to the following feature specific
# variables from each machine's config file
AMD_PLATFORM_SPECIFIC_PKGS ?= ""
AMD_FEATURE_MULTIMEDIA_PKGS ?= ""
AMD_FEATURE_GRAPHICS_PKGS ?= ""
AMD_FEATURE_NETWORKING_PKGS ?= ""
AMD_FEATURE_DEBUG_PROFILE_PKGS ?= ""

FEATURE_PACKAGES_amd-misc-pkgs = "\
    bc \
    ${AMD_PLATFORM_SPECIFIC_PKGS} \
"

FEATURE_PACKAGES_amd-feature-multimedia = "\
    ${GSTREAMER_PKGS} \
    ${@bb.utils.contains("IMAGE_FEATURES", "x11-base", "vdpauinfo", "", d)} \
    ${AMD_FEATURE_MULTIMEDIA_PKGS} \
"

FEATURE_PACKAGES_amd-feature-graphics = "\
    ${@bb.utils.contains("INCLUDE_VULKAN", "yes", "${VULKAN_PKGS}", "", d)} \
    ${AMD_FEATURE_GRAPHICS_PKGS} \
"
FEATURE_PACKAGES_amd-feature-graphics:append:radeon = " ${@bb.utils.contains("IMAGE_FEATURES", "x11-base", "mesa-demos", "", d)}"

FEATURE_PACKAGES_amd-feature-networking = "\
    ${DPDK_PKGS} \
    strongswan \
    ${AMD_FEATURE_NETWORKING_PKGS} \
"

FEATURE_PACKAGES_amd-feature-debug-profile = "\
    ${@bb.utils.contains("INCLUDE_CODEXL", "yes", "${CODEXL_PKGS}", "", d)} \
    ${AMD_FEATURE_DEBUG_PROFILE_PKGS} \
"
```

## meta-amd-bsp/conf/machine/include/amdx86.inc
```bitbake
PREFERRED_PROVIDER_virtual/kernel ?= "${@bb.utils.contains('RT_KERNEL_AMD', 'yes', "linux-yocto-rt", "linux-yocto", d)}"

require conf/machine/include/amd-common-configurations.inc
include conf/machine/include/amd-customer-configurations.inc

# Add machine specific AMD features and feature pkgs here
DPDK_PKGS = "${@bb.utils.contains("BBFILE_COLLECTIONS", "dpdk", "dpdk dpdk-examples dpdk-tools dpdk-module", "", d)}"

MACHINE_FEATURES:remove = "screen alsa"
MACHINE_EXTRA_RRECOMMENDS:remove = " rtc-test alsa-utils"

# Disable the graphical console when machine does not have a screen.
# This allows the serial console to be used for installation.
APPEND:remove="${@bb.utils.contains('MACHINE_FEATURES', 'screen-console', '', 'console=tty0', d)}"

MACHINEOVERRIDES =. "amd:amdx86:"

# Mask out recipes for packages we do not support for
# amdx86 but may be required by others. Use '|' sign
# between the patterns.
BBMASK = "\
.*/meta-amd/common/recipes-support/libtinyxml\
"
```

## meta-amd-bsp/conf/machine/include/quartz.inc
```bitbake
require conf/machine/include/x86/x86-base.inc

SERIAL_CONSOLES = "115200;ttyS0"

APPEND += "console=tty0 console=ttyS0,115200n8"

MACHINE_FEATURES += "efi"
```

## meta-amd-bsp/conf/machine/include/tune-zen1.inc
```bitbake
DEFAULTTUNE ?= "zen1"

require conf/machine/include/x86/arch-x86.inc

TUNEVALID[zen1] = "Enable AMD x86 (64 bit) Zen 1 Core Architecture specific optimizations"
TUNECONFLICTS[zen1] = "m32 mx32"

TUNE_CCARGS .= "${@bb.utils.contains('TUNE_FEATURES', 'zen1', ' -march=znver1', '', d)}"
MACHINEOVERRIDES =. "${@bb.utils.contains('TUNE_FEATURES', 'zen1', 'zen1:', '', d)}"

AVAILTUNES += "zen1"
TUNE_FEATURES:tune-zen1         = "${TUNE_FEATURES:tune-x86-64} zen1"
TUNE_PKGARCH:tune-zen1          = "zen1"
PACKAGE_EXTRA_ARCHS:tune-zen1   = "${PACKAGE_EXTRA_ARCHS:tune-x86-64} zen1"
BASE_LIB:tune-zen1              = "lib64"

# user mode qemu doesn't support zen1
MACHINE_FEATURES_BACKFILL_CONSIDERED:append = " ${@bb.utils.contains('TUNE_FEATURES', 'zen1', 'qemu-usermode', '', d)}"
```

## meta-amd-bsp/conf/machine/include/tune-zen2.inc
```bitbake
DEFAULTTUNE ?= "zen2"

require conf/machine/include/tune-zen1.inc

TUNEVALID[zen2] = "Enable AMD x86 (64 bit) Zen 2 Core Architecture specific optimizations"
TUNECONFLICTS[zen2] = "m32 mx32"

TUNE_CCARGS .= "${@bb.utils.contains('TUNE_FEATURES', 'zen2', ' -march=znver2', '', d)}"
MACHINEOVERRIDES =. "${@bb.utils.contains('TUNE_FEATURES', 'zen2', 'zen2:', '', d)}"

AVAILTUNES += "zen2"
TUNE_FEATURES:tune-zen2         = "${TUNE_FEATURES:tune-x86-64} zen2"
TUNE_PKGARCH:tune-zen2          = "zen2"
PACKAGE_EXTRA_ARCHS:tune-zen2   = "${PACKAGE_EXTRA_ARCHS:tune-zen1} zen2"
BASE_LIB:tune-zen2              = "lib64"

# user mode qemu doesn't support zen2
MACHINE_FEATURES_BACKFILL_CONSIDERED:append = " ${@bb.utils.contains('TUNE_FEATURES', 'zen2', 'qemu-usermode', '', d)}"
```

## meta-amd-bsp/conf/machine/include/tune-zen4.inc
```bitbake
DEFAULTTUNE ?= "zen4"

require conf/machine/include/tune-zen3.inc

TUNEVALID[zen4] = "Enable AMD x86 (64 bit) Zen 3 Core Architecture specific optimizations"
TUNECONFLICTS[zen4] = "m32 mx32"

TUNE_CCARGS .= "${@bb.utils.contains('TUNE_FEATURES', 'zen4', ' -march=znver3', '', d)}"
MACHINEOVERRIDES =. "${@bb.utils.contains('TUNE_FEATURES', 'zen4', 'zen4:', '', d)}"

AVAILTUNES += "zen4"
TUNE_FEATURES:tune-zen4         = "${TUNE_FEATURES:tune-x86-64} zen4"
TUNE_PKGARCH:tune-zen4          = "zen4"
PACKAGE_EXTRA_ARCHS:tune-zen4   = "${PACKAGE_EXTRA_ARCHS:tune-zen3} zen4"
BASE_LIB:tune-zen4              = "lib64"

# user mode qemu doesn't support zen4
MACHINE_FEATURES_BACKFILL_CONSIDERED:append = " ${@bb.utils.contains('TUNE_FEATURES', 'zen4', 'qemu-usermode', '', d)}"
```

## meta-amd-bsp/conf/machine/milan.conf
```bitbake
#@TYPE: Machine
#@NAME: milan

#@DESCRIPTION: Machine configuration for milan systems

require conf/machine/include/tune-zen3.inc
require conf/machine/include/ethanolx.inc
```

## meta-amd-bsp/conf/machine/rome.conf
```bitbake
#@TYPE: Machine
#@NAME: rome

#@DESCRIPTION: Machine configuration for rome systems

require conf/machine/include/tune-zen2.inc
require conf/machine/include/ethanolx.inc
# Include common configuration
include conf/machine/common.conf
```

## meta-amd-bsp/conf/machine/siena.conf
```bitbake
#@TYPE: Machine
#@NAME: Siena

#@DESCRIPTION: Machine configuration for Siena systems

require conf/machine/include/tune-zen4.inc
require conf/machine/include/uart.inc

MACHINE_EXTRA_RRECOMMENDS += "kernel-modules linux-firmware cmake util-linux "
# Include common configuration
include conf/machine/common.conf
```

## meta-amd-bsp/conf/machine/v2000.conf
```bitbake
#@TYPE: Machine
#@NAME: v2000

#@DESCRIPTION: Machine configuration for Siena systems

require conf/machine/include/tune-zen2.inc
require conf/machine/include/uart.inc

MACHINE_EXTRA_RRECOMMENDS += "git gdb make cmake gcc g++ vim libkcapi libtool util-linux"
 
# Include common configuration

PREFERRED_VERSION_linux-yocto = "6.6.26"

MACHINE_EXTRA_RRECOMMENDS += "git gdb make cmake gcc g++ vim libkcapi libtool util-linux libvirt elfutils usbredir libxext pavucontrol ceph libaio iscsi-initiator-utils usbredir spice-protocol spice pixman libxslt virt-viewer qemu kvmtool libtool libkcapi dmidecode stressapptest spidev-test"

KERNEL_MODULE_AUTOLOAD += "nvmem_core nvme nvme-common nvmem cxl cxl_mem cxl_port cxl_core spi-amd ntb_netdev spi-amd pci-cxl cxl_acpi cxl_pmem cxl_pci spi"

PACKAGE_CLASSES ?= "package_rpm"

IMAGE_INSTALL:append = " glmark2  mesa-demos linux-firmware kernel-modules"

MACHINE_ESSENTIAL_EXTRA_RRECOMMENDS += "kernel-modules"
KERNEL_MODULE_AUTOLOAD += "spi-amd"

include conf/machine/common.conf

XSERVER ?= "xserver-xorg \
             xf86-video-amdgpu \
         "
```
