## conf/machine/mvme2500.conf
```bitbake
#@TYPE: Machine
#@NAME: MVME2500 machine
#@DESCRIPTION: Machine configuration for MVME2500 https://www.artesyn.com/computing/products/product/mvme2500-series-vme64-processor-board

require conf/machine/include/artesyn.inc
require conf/machine/include/tune-ppce500v2.inc

SERIAL_CONSOLE = "9600 ttyS0"

KERNEL_IMAGETYPE = "zImage"
DEVICETREE = "mvme2500.dtb"
KERNEL_DEVICETREE = "fsl/${DEVICETREE}"

MACHINE_FEATURES = "pci serial ext2 usbhost"

IMAGE_BOOT_FILES ?= " \
	${DEVICETREE} \
	${KERNEL_IMAGETYPE} \
	"

IMAGE_FSTYPES ?= "tar"
WKS_FILE ?= "sdimage-bootpart.wks"

MACHINEOVERRIDES =. "vme:ppce500v2:"
TUNE_FEATURES_tune-ppce500v2 += "spe"

# TODO Remove u-boot-mkimage
MACHINE_ESSENTIAL_EXTRA_RRECOMMENDS_append = " u-boot-dummy kernel-modules u-boot-mkimage"

PRIMARY_NETIF = "eth0"
ROOT = ""

# Obtain the right cross-canadian toolchain
TARGET_SYS_pn-gcc-cross-canadian-powerpc = "powerpc-voltumna-linux-gnuspe"
bindir_append_pn-gcc-cross-canadian-powerpc = "-gnuspe"
libdir_append_pn-gcc-cross-canadian-powerpc = "-gnuspe"
libexecdir_append_pn-gcc-cross-canadian-powerpc = "-gnupse"
```

## conf/machine/mvme5100.conf
```bitbake
#@TYPE: Machine
#@NAME: MVME5100 machine
#@DESCRIPTION: Machine configuration for MVME5100

require conf/machine/include/artesyn.inc
require conf/machine/include/tune-ppc7400.inc

SERIAL_CONSOLE = "9600 ttyS0"

KERNEL_IMAGETYPE = "dtbImage.mvme5100"

MACHINE_FEATURES = "pci serial"

IMAGE_FSTYPES ?= "tar"

ALLOW_EMPTY_${KERNEL_PACKAGE_NAME}-devicetree = "1"

MACHINEOVERRIDES =. "vme:ppc7400:"

MACHINE_ESSENTIAL_EXTRA_RRECOMMENDS_append = " kernel-modules"

PRIMARY_NETIF = "enp0s14"
ROOT = ""
```

## conf/machine/mvme6100.conf
```bitbake
#@TYPE: Machine
#@NAME: MVME6100 machine
#@DESCRIPTION: Machine configuration for MVME6100

require conf/machine/include/artesyn.inc
require conf/machine/powerpc/tune-ppc7450.inc

SERIAL_CONSOLE = "9600 ttyS0"

KERNEL_IMAGETYPE = "dtbImage.mvme6100"

MACHINE_FEATURES = "pci serial"

IMAGE_FSTYPES ?= "tar.gz"

ALLOW_EMPTY:${KERNEL_PACKAGE_NAME}-devicetree = "1"
```

## conf/machine/mvme7100.conf
```bitbake
#@TYPE: Machine
#@NAME: MVME7100 machine
#@DESCRIPTION: Machine configuration for MVME7100 https://www.artesyn.com/computing/products/product/mvme7100-vme-sbc-with-freescale-mpc864xd-system-on-chip-processor

require conf/machine/include/artesyn.inc
require conf/machine/include/tune-ppc7400.inc

SERIAL_CONSOLE = "9600 ttyS0"

KERNEL_IMAGETYPE = "dtbImage.mvme7100"

MACHINE_FEATURES = "pci serial ext2 usbhost"

IMAGE_FSTYPES ?= "tar.gz"

ALLOW_EMPTY_${KERNEL_PACKAGE_NAME}-devicetree = "1"
```

## conf/machine/nu93-2930.conf
```bitbake
#@TYPE: Machine
#@NAME: NU93-2930
#@DESCRIPTION: Machine configuration for Jetway NU93-2930 X86 (64-bit): http://www.jetwaycomputer.com/NU93.html

# Silvermont?????

require include/intel-common.inc
require include/tune-nehalem.inc

IMAGE_FSTYPES = "tar"

PRIMARY_NETIF = "eth0"
ROOT = "/dev/sda2"

EXTRA_IMAGEDEPENDS += "grub-efi"
PREFERRED_PROVIDER_virtual/bootloader = "grub-efi"

MACHINE_EXTRA_RRECOMMENDS:remove = "linux-firmware"

OPENBLAS_TARGET = "NEHALEM"

COMPATIBLE_MACHINE:pn-dpdk = "nu93-2930"
COMPATIBLE_MACHINE:pn-dpdk-module = "nu93-2930"
DEPENDS:pn-dpdk:remove = "numactl"
```

## conf/machine/qemu-nehalem-64.conf
```bitbake
#@TYPE: Machine
#@NAME: QEMU nehalem-64 machine
#@DESCRIPTION: Machine configuration for running an mehalem-64 system on QEMU

require include/intel-common.inc
require include/tune-nehalem.inc

MACHINE_EXTRA_RRECOMMENDS_remove = "kernel-modules linux-firmware"
MACHINE_ESSENTIAL_EXTRA_RRECOMMENDS_remove = " kernel-module-i915 linux-firmware-i915"

MACHINEOVERRIDES =. "qemux86-64:"
IMAGE_INSTALL_remove = "kernel-image kernel-devicetree kernel-modules linux-firmware"

PREFERRED_PROVIDER_zlib = "zlib-intel"

PRIMARY_NETIF = "eth0 eth0"
```

## conf/machine/qemu-ppce500v2.conf
```bitbake
#@TYPE: Machine
#@NAME: QEMU PPC machine using SPE instructions set
#@DESCRIPTION: Machine configuration for running a PPC SPE system on QEMU

require conf/machine/include/qemu.inc
require conf/machine/include/tune-ppce500v2.inc

TUNE_FEATURES_tune-ppce500v2 += "spe"

KERNEL_IMAGETYPE = "vmlinux"

SERIAL_CONSOLES ?= "115200;ttyS0 115200;ttyS1"

# For runqemu
QB_SYSTEM_NAME = "qemu-system-ppc"
QB_MACHINE = "-machine ppce500"
QB_CPU = "-cpu e500v2"
QB_KERNEL_CMDLINE_APPEND = "console=tty console=ttyS0"
QB_OPT_APPEND = "-show-cursor -usb -device usb-tablet"
# Add the 'virtio-rng-pci' device otherwise the guest may run out of entropy
QB_OPT_APPEND += "-object rng-random,filename=/dev/urandom,id=rng0 -device virtio-rng-pci,rng=rng0"
QB_TAP_OPT = "-netdev tap,id=net0,ifname=@TAP@,script=no,downscript=no"

MACHINEOVERRIDES =. "qemuppc:"
PREFERRED_PROVIDER_virtual/kernel = "linux-dummy"
IMAGE_INSTALL_remove ="kernel-image kernel-devicetree"
```

## conf/machine/qemu-skylake-64.conf
```bitbake
#@TYPE: Machine
#@NAME: QEMU skylake-64 machine
#@DESCRIPTION: Machine configuration for running an skylake-64 system on QEMU

require include/intel-common.inc
require include/tune-skylake.inc

RDEPENDS_${PN}_remove = "kernel"

MACHINEOVERRIDES =. "qemux86-64:"
PREFERRED_PROVIDER_virtual/kernel = "linux-dummy"
IMAGE_INSTALL_remove ="kernel-image kernel-devicetree"

PREFERRED_PROVIDER_zlib = "zlib-intel"
```

## conf/machine/s-4125r-x11spw-tf.conf
```bitbake
#@TYPE: Machine
#@NAME: s-4215r-x11spw-tf
#@DESCRIPTION: Machine configuration for a single-socket 4125R Intel processor on Supermicro X11SPW-TF motherboard (64-bit)

require include/intel-common.inc
require include/tune-cascadelake.inc

MACHINEOVERRIDES =. "s-4125r:x11spw-tf:"

IMAGE_FSTYPES = "tar"

PRIMARY_NETIF = "eno1"
ROOT = "/dev/sda2"

EXTRA_IMAGEDEPENDS += "grub-efi grub-bootconf"

WKS_FILE = "grub-bootdisk-microcode.wks.in"

MACHINE_ESSENTIAL_EXTRA_RRECOMMENDS_remove = "linux-firmware"
```

## conf/machine/s-4305ue-up-whl01.conf
```bitbake
#@TYPE: Machine
#@NAME: s-4305ue-up-whl01
#@DESCRIPTION: Machine configuration for a single-socket 4305UE Intel processor on UP-Board UP-WHL01 motherboard (64-bit)

require include/intel-common.inc
require include/tune-skylake.inc

MACHINEOVERRIDES =. "s-4305ue:up-whl01:"

IMAGE_FSTYPES = "tar wic wic.bmap"

PRIMARY_NETIF = "eno1"
ROOT = "/dev/sda2"

EXTRA_IMAGEDEPENDS += "grub-efi grub-bootconf"

WKS_FILE = "grub-bootdisk-microcode.wks.in"

MACHINE_ESSENTIAL_EXTRA_RRECOMMENDS_remove = "linux-firmware"
MACHINE_ESSENTIAL_EXTRA_RRECOMMENDS_append = " dpdk"
```

## conf/machine/s-d1718t-x12sdv-4c-sp6f.conf
```bitbake
#@TYPE: Machine
#@NAME: 
#@DESCRIPTION: Machine configuration for a single-socket Xeon D-1718T Intel processor on Supermicro x12sdv-4c-sp6g motherboard (64-bit)

require include/intel-common.inc
require include/tune-icelake-server.inc

MACHINEOVERRIDES =. "s-d1718t:x12sdv-4c-sp6f:"

IMAGE_FSTYPES = "tar"

PRIMARY_NETIF = "eno1"
ROOT = "/dev/sda2"

EXTRA_IMAGEDEPENDS += "grub-efi grub-bootconf"
PREFERRED_PROVIDER_virtual/bootloader = "grub-efi"

MACHINE_EXTRA_RRECOMMENDS:remove = "linux-firmware"
MACHINE_EXTRA_RRECOMMENDS:append = " bios intel-ethernet-550-firmware \
	intel-ethernet-700-firmware intel-ethernet-810-firmware"

OPENBLAS_TARGET = "SKYLAKEX"

COMPATIBLE_MACHINE:pn-dpdk = "s-d1718t-x12sdv-4c-sp6f"
COMPATIBLE_MACHINE:pn-nativesdk-dpdk = "(.*)"
```

## conf/machine/s-x6425e-a3sev-4c-ln4.conf
```bitbake
#@TYPE: Machine
#@NAME: 
#@DESCRIPTION: Machine configuration for a single-socket Atom x6425e Intel processor on Supermicro a3sev-4c-ln4 motherboard (64-bit)

require include/intel-common.inc
require include/tune-tremont.inc

MACHINEOVERRIDES =. "s-x6425e:a3sev-4c-ln4:"

IMAGE_FSTYPES = "tar"

PRIMARY_NETIF = "eno1"
ROOT = "/dev/sda2"

EXTRA_IMAGEDEPENDS += "grub-efi grub-bootconf"
PREFERRED_PROVIDER_virtual/bootloader = "grub-efi"

MACHINE_EXTRA_RRECOMMENDS:remove = "linux-firmware"
MACHINE_EXTRA_RRECOMMENDS:append = " bios intel-ethernet-550-firmware \
	intel-ethernet-700-firmware intel-ethernet-810-firmware"

OPENBLAS_TARGET = "ATOM"

COMPATIBLE_MACHINE:pn-dpdk = "s-x6425e-a3sev-4c-ln4"
COMPATIBLE_MACHINE:pn-nativesdk-dpdk = "(.*)"
```
