## conf/machine/dinet.conf
```bitbake
#@TYPE: Machine
#@NAME: Dinet machine
#@DESCRIPTION: Machine configuration for the Dinet board 

DEFAULTTUNE = "cortexa9hf-neon"
require include/cyclone5.conf
MACHINEOVERRIDES =. "cyclone5:"

UBOOT_CONFIG[dinet] = "socfpga_dinet_defconfig"
UBOOT_CONFIG = "dinet"
UBOOT_EXTLINUX = "0"
KERNEL_DEVICETREE:append = "\
			socfpga_cyclone5_dinet.dtb \
			"

PRIMARY_NETIF = "eth0"
ROOT = "root=/dev/mmcblk0p3"
ROOTUSB = "root=/dev/sda3"
WKS_FILE = "sdimage-cyclone5-arria5.wks"

IMAGE_FSTYPES = "tar wic wic.bmap"

IMAGE_BOOT_FILES:remove = "extlinux.conf;extlinux/extlinux.conf"
IMAGE_BOOT_FILES:append = "boot.scr.uimg uEnv.txt"

MACHINE_EXTRA_RRECOMMENDS:append = " kernel-modules mtd-utils"

MACHINE_FEATURES:remove = "qemu-usermode"
OPENBLAS_TARGET = "CORTEXA9"
```

## conf/machine/include/artesyn.inc
```bitbake
KERNEL_PROVIDER ?= "linux-artesyn"
PREFERRED_PROVIDER_virtual/kernel ?= "${KERNEL_PROVIDER}"

MACHINE_ESSENTIAL_EXTRA_RDEPENDS:append = "kernel-modules kernel-devicetree"
```

## conf/machine/include/intel-common.inc
```bitbake
require conf/machine/include/meta-intel.inc
require conf/machine/include/x86-base.inc

MACHINE_FEATURES += "efi"
# MACHINE_FEATURES += "wifi 3g nfc"
MACHINE_FEATURES += "intel-ucode"

MACHINE_HWCODECS ?= "intel-media-driver intel-mediasdk intel-vaapi-driver gstreamer1.0-vaapi"

# Enable optional dpdk:
COMPATIBLE_MACHINE_pn-dpdk = "intel-corei7-64"

# Enable optional QAT items:
COMPATIBLE_MACHINE_pn-qat16 = "intel-corei7-64"
COMPATIBLE_MACHINE_pn-qat17 = "intel-corei7-64"
COMPATIBLE_MACHINE_pn-zlib-qat = "intel-corei7-64"

XSERVER ?= "${XSERVER_X86_BASE} \
            ${XSERVER_X86_EXT} \
            ${XSERVER_X86_FBDEV} \
            ${XSERVER_X86_I915} \
            ${XSERVER_X86_I965} \
            ${XSERVER_X86_MODESETTING} \
            ${XSERVER_X86_VESA} \
            ${XSERVER_X86_ASPEED_AST} \
           "

SYSLINUX_OPTS = "serial 0 115200"
SERIAL_CONSOLES = "115200;ttyS0 115200;ttyS1 115200;ttyS2"
APPEND += "rootwait console=ttyS0,115200 console=tty0"

IMAGE_FSTYPES += "wic"
WKS_FILE ?= "grub-bootdisk-microcode.wks.in"
WKS_FILE_DEPENDS_append = " intel-microcode"

KMACHINE = "intel-corei7-64"
ALLOW_EMPTY_${KERNEL_PACKAGE_NAME}-devicetree = "1"
MACHINEOVERRIDES =. "intel-corei7-64:"

EFI_PROVIDER = ""
```

## conf/machine/include/naples.inc
```bitbake
#@TYPE: Machine
#@NAME: Naples

#@DESCRIPTION: Machine configuration for Naples systems

require conf/machine/include/tune-zen1.inc
require conf/machine/include/quartz.inc

MACHINEOVERRIDES =. "amd:"
ALLOW_EMPTY:${KERNEL_PACKAGE_NAME}-devicetree = "1"
MACHINE_FEATURES += "efi"
EFI_PROVIDER = ""
WKS_FILE ?= "grub-bootdisk.wks"
```

## conf/machine/include/tune-broadwell.inc
```bitbake
# Settings for the GCC(1) cpu-type "broadwell":
#
#     Intel Broadwell CPU with 64-bit extensions, MOVBE, MMX, SSE, SSE2, SSE3, SSSE3, 
#     SSE4.1, SSE4.2, POPCNT, AVX, AVX2, AES, PCLMUL, FSGSBASE, RDRND, FMA, 
#     BMI, BMI2, F16C, RDSEED ADCX and PREFETCHW instruction set support.
#
# This tune is recommended for Intel Broadwell CPU (and beyond).
#
DEFAULTTUNE ?= "broadwell-64"

# Include the previous tune to pull in PACKAGE_EXTRA_ARCHS
require conf/machine/include/x86/tune-corei7.inc

# Extra tune features
TUNEVALID[broadwell] = "Enable broadwell specific processor optimizations"
TUNE_CCARGS .= "${@bb.utils.contains('TUNE_FEATURES', 'broadwell', ' -march=broadwell ${BROADWELL_TUNE} -mfpmath=sse', '', d)}"

# Extra tune selections

AVAILTUNES += "broadwell-64"
TUNE_FEATURES:tune-broadwell-64 = "${TUNE_FEATURES:tune-x86-64} broadwell"
BASE_LIB:tune-broadwell-64 = "lib64"
TUNE_PKGARCH:tune-broadwell-64 = "broadwell-64"
PACKAGE_EXTRA_ARCHS:tune-broadwell-64 = "${PACKAGE_EXTRA_ARCHS:tune-corei7-64} broadwell-64"
QEMU_EXTRAOPTIONS_broadwell-64 = " -cpu broadwell"


# Disable QEMU usermode by default (get avx2)
MACHINE_FEATURES:remove = "qemu-usermode"

# If qemu-usermode is enabled, we have to disable avx2 ISA extensions, but we can keep mtune as broadwell vs generic
BROADWELL_TUNE .= "${@bb.utils.contains('MACHINE_FEATURES', 'qemu-usermode', ' -mtune=broadwell', '-mtune=generic -mavx2', d)}"
```

## conf/machine/include/tune-cascadelake.inc
```bitbake
# Settings for the GCC(1) cpu-type "cascadelake":
#
#     Intel Cascadelake CPU with 64-bit extensions, MOVBE, MMX, SSE, SSE2, SSE3, SSSE3,
#     SSE4.1, SSE4.2, POPCNT, PKU, AVX, AVX2, AES, PCLMUL, FSGSBASE, RDRND, FMA, BMI,
#     BMI2, F16C, RDSEED, ADCX, PREFETCHW, CLFLUSHOPT, XSAVEC, XSAVES, AVX512F, CLWB,
#     AVX512VL, AVX512BW, AVX512DQ, AVX512CD and AVX512VNNI instruction set support.
#
# This tune is recommended for Intel Cascadelake CPU (and beyond).
#
DEFAULTTUNE ?= "cascadelake-64"

# Include the previous tune to pull in PACKAGE_EXTRA_ARCHS
require conf/machine/include/tune-corei7.inc

# Extra tune features
TUNEVALID[cascadelake] = "Enable cascadelake specific processor optimizations"
TUNE_CCARGS .= "${@bb.utils.contains('TUNE_FEATURES', 'cascadelake', ' -march=cascadelake ${CASCADELAKE_TUNE} -mfpmath=sse', '', d)}"

# Extra tune selections

AVAILTUNES += "cascadelake-64"
TUNE_FEATURES_tune-cascadelake-64 = "${TUNE_FEATURES_tune-x86-64} cascadelake"
BASE_LIB_tune-cascadelake-64 = "lib64"
TUNE_PKGARCH_tune-cascadelake-64 = "cascadelake-64"
PACKAGE_EXTRA_ARCHS_tune-cascadelake-64 = "${PACKAGE_EXTRA_ARCHS_tune-core2-64} cascadelake-64"
QEMU_EXTRAOPTIONS_cascadelake-64 = " -cpu Cascadelake-Server"

CASCADELAKE_TUNE .= "${@bb.utils.contains('MACHINE_FEATURES', 'qemu-usermode', ' ${QEMU_UNAVAILABLE_ISA}', '-mavx2', d)}"

QEMU_UNAVAILABLE_ISA = " \
-mno-avx \
-mno-avx2 \
-mno-avx512f \
-mno-avx512cd \
-mno-avx512dq \
-mno-avx512bw \
-mno-avx512vl \
-mno-avx512ifma \
-mno-avx512vbmi \
-mno-avx512vbmi2 \
-mno-avx512vnni \
-mno-avx512bitalg \
"

OPENBLAS_TARGET = "SKYLAKEX"
```

## conf/machine/include/tune-icelake-server.inc
```bitbake
# Settings for the GCC(1) cpu-type "icelake-server":
#
#     Intel Icelake Server CPU with 64-bit extensions, MOVBE, MMX, SSE, SSE2, SSE3, SSSE3,
#     SSE4.1, SSE4.2, POPCNT, PKU, AVX, AVX2, AES, PCLMUL, FSGSBASE, RDRND, FMA, BMI,
#     BMI2, F16C, RDSEED, ADCX, PREFETCHW, CLFLUSHOPT, XSAVEC, XSAVES, AVX512F,
#     AVX512VL, AVX512BW, AVX512DQ, AVX512CD, AVX512VBMI, AVX512IFMA, SHA, CLWB, UMIP,
#     RDPID, GFNI, AVX512VBMI2, AVX512VPOPCNTDQ, AVX512BITALG, AVX512VNNI, VPCLMULQDQ,
#     VAES, PCONFIG and WBNOINVD instruction set support.
#
# This tune is recommended for Intel Icelake server CPU (and beyond).
#
DEFAULTTUNE ?= "icelake-server-64"

# Include the previous tune to pull in PACKAGE_EXTRA_ARCHS
require conf/machine/include/tune-corei7.inc

# Extra tune features
TUNEVALID[icelake-server] = "Enable icelake-server pecific processor optimizations"
TUNE_CCARGS .= "${@bb.utils.contains('TUNE_FEATURES', 'icelake-server', ' -march=icelake-server ${ICELAKESERVER_TUNE} -mfpmath=sse', '', d)}"

# Extra tune selections

AVAILTUNES += "icelake-server-64"
TUNE_FEATURES_tune-icelake-server-64 = "${TUNE_FEATURES_tune-x86-64} icelake-server"
BASE_LIB_tune-icelake-server-64 = "lib64"
TUNE_PKGARCH_tune-icelake-server-64 = "icelake-server-64"
PACKAGE_EXTRA_ARCHS_tune-icelake-server-64 = "${PACKAGE_EXTRA_ARCHS_tune-core2-64} icelake-server-64"
QEMU_EXTRAOPTIONS_icelake-server-64 = " -cpu Icelake-Server"

ICELAKESERVER_TUNE .= "${@bb.utils.contains('MACHINE_FEATURES', 'qemu-usermode', ' ${QEMU_UNAVAILABLE_ISA}', '-mavx2', d)}"

QEMU_UNAVAILABLE_ISA = " \
-mno-avx \
-mno-avx2 \
-mno-avx512f \
-mno-avx512cd \
-mno-avx512dq \
-mno-avx512bw \
-mno-avx512vl \
-mno-avx512ifma \
-mno-avx512vbmi \
-mno-avx512vbmi2 \
-mno-avx512vnni \
-mno-avx512bitalg \
"

OPENBLAS_TARGET = "SKYLAKEX"
```

## conf/machine/include/tune-ivybridge.inc
```bitbake
# Settings for the GCC(1) cpu-type "ivybridge":
#
#     Intel Ivy Bridge CPU with 64-bit extensions, MMX, SSE, SSE2, SSE3, SSSE3, SSE4.1, 
#     SSE4.2, POPCNT, AVX, AES, PCLMUL, FSGSBASE, RDRND and F16C instruction set support.
#
# This tune is recommended for Intel Ivy Bridge CPUs (and beyond).
#
DEFAULTTUNE ?= "ivybridge-64"

# Include the previous tune to pull in PACKAGE_EXTRA_ARCHS
require conf/machine/include/x86/tune-core2.inc

# Extra tune features
TUNEVALID[ivybridge] = "Enable ivybridge specific processor optimizations"
TUNE_CCARGS .= "${@bb.utils.contains('TUNE_FEATURES', 'ivybridge', ' -march=ivybridge ${QEMU_UNAVAILABLE_ISA} -mfpmath=sse', '', d)}"

# Extra tune selections
AVAILTUNES += "ivybridge-64"
TUNE_FEATURES:tune-ivybridge-64 = "${TUNE_FEATURES:tune-x86-64} ivybridge"
BASE_LIB:tune-ivybridge-64 = "lib64"
TUNE_PKGARCH:tune-ivybridge-64 = "ivybridge-64"
PACKAGE_EXTRA_ARCHS:tune-ivybridge-64 = "${PACKAGE_EXTRA_ARCHS:tune-core2-64} ivybridge-64"
QEMU_EXTRAOPTIONS_ivybridge-64 = " -cpu IvyBridge"

IVYBRIDGE_TUNE .= "${@bb.utils.contains('MACHINE_FEATURES', 'qemu-usermode', ' ${QEMU_UNAVAILABLE_ISA}', '-mtune=generic -mavx', d)}"

QEMU_UNAVAILABLE_ISA = " \
-mno-avx \
-mno-avx2 \
-mno-avx512f \
-mno-avx512er \
-mno-avx512cd \
-mno-avx512pf \
-mno-avx512dq \
-mno-avx512bw \
-mno-avx512vl \
-mno-avx512ifma \
-mno-avx512vbmi \
-mno-avx512vbmi2 \
-mno-avx512vnni \
-mno-avx512bitalg \
"
```

## conf/machine/include/tune-nehalem.inc
```bitbake
# Settings for the GCC(1) cpu-type "nehalem":
#
#     Intel Nehalem CPU with 64-bit extensions, MMX, SSE, SSE2, SSE3, SSSE3, SSE4.1,
#     SSE4.2 and POPCNT instruction set support.
#
# This tune is recommended for Intel Nehalem and Silvermont (e.g. Bay Trail) CPUs
# (and beyond).
#
DEFAULTTUNE ?= "nehalem-64"

# Include the previous tune to pull in PACKAGE_EXTRA_ARCHS
require conf/machine/include/tune-core2.inc

# Extra tune features
TUNEVALID[nehalem] = "Enable nehalem specific processor optimizations"
TUNE_CCARGS .= "${@bb.utils.contains('TUNE_FEATURES', 'nehalem', ' -march=nehalem -mfpmath=sse -msse4.2', '', d)}"

# Extra tune selections
AVAILTUNES += "nehalem-32"
TUNE_FEATURES_tune-nehalem-32 = "${TUNE_FEATURES_tune-x86} nehalem"
BASE_LIB_tune-nehalem-32 = "lib"
TUNE_PKGARCH_tune-nehalem-32 = "nehalem-32"
PACKAGE_EXTRA_ARCHS_tune-nehalem-32 = "${PACKAGE_EXTRA_ARCHS_tune-core2-32} nehalem-32"
QEMU_EXTRAOPTIONS_nehalem-32 = " -cpu Nehalem,check=false"

AVAILTUNES += "nehalem-64"
TUNE_FEATURES_tune-nehalem-64 = "${TUNE_FEATURES_tune-x86-64} nehalem"
BASE_LIB_tune-nehalem-64 = "lib64"
TUNE_PKGARCH_tune-nehalem-64 = "nehalem-64"
PACKAGE_EXTRA_ARCHS_tune-nehalem-64 = "${PACKAGE_EXTRA_ARCHS_tune-core2-64} nehalem-64"
QEMU_EXTRAOPTIONS_nehalem-64 = " -cpu Nehalem,check=false"

AVAILTUNES += "nehalem-64-x32"
TUNE_FEATURES_tune-nehalem-64-x32 = "${TUNE_FEATURES_tune-x86-64-x32} nehalem"
BASE_LIB_tune-nehalem-64-x32 = "libx32"
TUNE_PKGARCH_tune-nehalem-64-x32 = "nehalem-64-x32"
PACKAGE_EXTRA_ARCHS_tune-nehalem-64-x32 = "${PACKAGE_EXTRA_ARCHS_tune-core2-64-x32} nehalem-64-x32"
QEMU_EXTRAOPTIONS_nehalem-64-x32 = " -cpu Nehalem,check=false"

OPENBLAS_TARGET = "NEHALEM"
```

## conf/machine/include/tune-penryn.inc
```bitbake
# Settings for the GCC(1) cpu-type "core2":
#
#     Intel Penryn CPU with 64-bit extensions, MMX, SSE, SSE2, SSE3, SSSE3, SSE4.1
#     instruction set support.
#
# This tune is recommended for Penryn CPUs (and beyond).
#
DEFAULTTUNE ?= "penryn-64"

# Include the previous tune to pull in PACKAGE_EXTRA_ARCHS
require conf/machine/include/x86/tune-core2.inc

# Extra tune features
TUNEVALID[penryn] = "Enable penryn specific processor optimizations"
TUNE_CCARGS .= "${@bb.utils.contains('TUNE_FEATURES', 'penryn', ' -march=core2 -mtune=core2 -msse4.1 -mfpmath=sse', '', d)}"

# Extra tune selections
AVAILTUNES += "penryn-64"
TUNE_FEATURES:tune-penryn-64 = "${TUNE_FEATURES:tune-x86-64} penryn"
BASE_LIB:tune-penryn-64 = "lib64"
TUNE_PKGARCH:tune-penryn-64 = "penryn-64"
PACKAGE_EXTRA_ARCHS:tune-penryn-64 = "${PACKAGE_EXTRA_ARCHS:tune-core2-64} penryn-64"
QEMU_EXTRAOPTIONS_penryn-64 = " -cpu Penryn"
```

## conf/machine/include/tune-skylake.inc
```bitbake
# Settings for the GCC(1) cpu-type "skylake":
#
#     Intel Skylake CPU with 64-bit extensions, MOVBE, MMX, SSE, SSE2, SSE3, SSSE3,
#     SSE4.1, SSE4.2, POPCNT, AVX, AVX2, AES, PCLMUL, FSGSBASE, RDRND, FMA, BMI,
#     BMI2, F16C, RDSEED, ADCX, PREFETCHW, CLFLUSHOPT, XSAVEC and XSAVES
#     instruction set support.
#
# This tune is recommended for Intel Skylake CPU (and beyond).
#
DEFAULTTUNE ?= "skylake-64"

# Include the previous tune to pull in PACKAGE_EXTRA_ARCHS
require conf/machine/include/tune-corei7.inc

# Extra tune features
TUNEVALID[skylake] = "Enable skylake specific processor optimizations"
TUNE_CCARGS .= "${@bb.utils.contains('TUNE_FEATURES', 'skylake', ' -march=skylake ${SKYLAKE_TUNE} -mfpmath=sse', '', d)}"

# Extra tune selections

AVAILTUNES += "skylake-64"
TUNE_FEATURES_tune-skylake-64 = "${TUNE_FEATURES_tune-x86-64} skylake"
BASE_LIB_tune-skylake-64 = "lib64"
TUNE_PKGARCH_tune-skylake-64 = "skylake-64"
PACKAGE_EXTRA_ARCHS_tune-skylake-64 = "${PACKAGE_EXTRA_ARCHS_tune-core2-64} skylake-64"
QEMU_EXTRAOPTIONS_skylake-64 = " -cpu Skylake-Client"

# If qemu-usermode is enabled, we have to disable avx2 ISA extensions, but we can keep mtune as skylake vs generic
SKYLAKE_TUNE .= "${@bb.utils.contains('MACHINE_FEATURES', 'qemu-usermode', ' -mtune=skylake ${QEMU_UNAVAILABLE_ISA}', '-mtune=generic -mavx2', d)}"

QEMU_UNAVAILABLE_ISA = " \
-mno-avx \
-mno-avx2 \
-mno-avx512f \
-mno-avx512cd \
-mno-avx512dq \
-mno-avx512bw \
-mno-avx512vl \
-mno-avx512ifma \
-mno-avx512vbmi \
-mno-avx512vbmi2 \
-mno-avx512vnni \
-mno-avx512bitalg \
"

OPENBLAS_TARGET = "HASWELL"
```

## conf/machine/kvm-naples.conf
```bitbake
#@TYPE: Machine
#@NAME: KVM virtual machine
#@DESCRIPTION: Machine configuration for the http://linux-kvm.org virtual machine 

require include/naples.inc

MACHINEOVERRIDES =. "kvm:"

IMAGE_FSTYPES = "wic"

PRIMARY_NETIF = "enp0s2f0"
ROOT = "root=/dev/vda2"

EXTRA_IMAGEDEPENDS += "grub-efi grub-bootconf"

PREFERRED_PROVIDER_virtual/bootloader = "grub-efi"

MACHINE_EXTRA_RRECOMMENDS:remove = "kernel-modules linux-firmware"
MACHINE_EXTRA_RRECOMMENDS:append = " kernel-module-efivars kernel-module-parport \
	kernel-module-parport-pc kernel-module-ata-piix kernel-module-uio \
	kernel-module-iwlwifi kernel-module-cfg80211 kernel-module-i915 \
	kernel-module-video"

COMPATIBLE_MACHINE:pn-nativesdk-dpdk = "(.*)"

MACHINE_ESSENTIAL_EXTRA_RDEPENDS:remove = "thermald"

OPENBLAS_TARGET = "ZEN"
```

## conf/machine/kvm-nehalem.conf
```bitbake
#@TYPE: Machine
#@NAME: KVM virtual machine
#@DESCRIPTION: Machine configuration for the http://linux-kvm.org virtual machine 

require include/intel-common.inc
require include/tune-nehalem.inc

MACHINEOVERRIDES =. "kvm:"

IMAGE_FSTYPES = "wic"

PRIMARY_NETIF = "enp0s2f0"
ROOT = "root=/dev/vda2"

EXTRA_IMAGEDEPENDS += "grub-efi grub-bootconf"

WKS_FILE = "grub-bootdisk-microcode.wks.in"

MACHINE_EXTRA_RRECOMMENDS_remove = "kernel-modules linux-firmware"
MACHINE_EXTRA_RRECOMMENDS_append = " kernel-module-efivars kernel-module-parport \
	kernel-module-parport-pc kernel-module-ata-piix kernel-module-uio \
	kernel-module-iwlwifi kernel-module-cfg80211 kernel-module-i915 \
	kernel-module-video"

MACHINE_ESSENTIAL_EXTRA_RDEPENDS_remove = "thermald"

OPENBLAS_TARGET = "NEHALEM"
```
