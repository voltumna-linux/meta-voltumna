## conf/distro/voltumna.conf
```bitbake
DISTRO ??= "voltumna"
DISTRO_NAME ??= "Voltumna"
DISTRO_CODENAME = "Meeting The Master"
DISTRO_VERSION = "4.0${IMAGE_VERSION}"
SDK_VENDOR ??= "-voltumnasdk"
SDK_VERSION = "${DISTRO_VERSION}"
SDK_VERSION[vardepvalue] = "${SDK_VERSION}"

MAINTAINER = "Alessio Igor Bogani <alessio.bogani@elettra.eu>"

TARGET_VENDOR ??= "-voltumna"

DISTRO_FEATURES = "acl xattr largefile keyboard ldconfig pci pam systemd \
	usbgadget usbhost wifi usrmerge polkit \
	api-documentation"

# Remove few distro features because we don't support bluetooth,
# audio and traditional init system
DISTRO_FEATURES_OPTED_OUT = " \
	pulseaudio sysvinit bluez5"

MACHINE_FEATURES += " qemu-usermode"

# Use reasonable kernel, image and sdk filenames
KERNEL_ARTIFACT_NAME = "${MACHINE}-${PKGE}-${PKGV}-${PKGR}"
KERNEL_IMAGEDEST = "usr/boot"

SDK_NAME_PREFIX = "${IMAGE_BASENAME}"
SDK_NAME = "${SDK_NAME_PREFIX}-${SDKMACHINE}-${MACHINE}"
SDKPATHINSTALL = "/opt/${SDK_NAME_PREFIX}/${SDK_VERSION}"
TOOLCHAIN_OUTPUTNAME = "${SDK_NAME}-${SDK_VERSION}"
SDK_PS1 = "${DISTRO_NAME} ${SDK_VERSION}"

IMAGE_NAME_SUFFIX = ""
IMAGE_VERSION_SUFFIX = ""
IMAGE_NAME = "${IMAGE_BASENAME}-${MACHINE}-${DISTRO_VERSION}"

# Use systemd
INIT_MANAGER = "systemd"
VIRTUAL-RUNTIME_init_manager = "systemd"
VIRTUAL-RUNTIME_initscripts = ""

# Avoid busybox
VIRTUAL-RUNTIME_base-utils = ""
VIRTUAL-RUNTIME_base-utils-hwclock = ""
VIRTUAL-RUNTIME_base-utils-syslog = ""
VIRTUAL-RUNTIME_login_manager = ""

# Disable creation of the tarball of modules
MODULE_TARBALL_DEPLOY = "0"

FILESYSTEM_PERMS_TABLES = "files/fs-perms-voltumna.txt"

# Avoid to download and use new packages inadvertently
BB_NO_NETWORK ??= "1"

# Use specific GCC version
GCCVERSION = "15.%"

# Use an initramfs
INITRAMFS_IMAGE_BUNDLE = "1"
INITRAMFS_IMAGE = "voltumna-initramfs"

# Set few defaults
ROOT_HOME = "/root"
LOCALE_UTF8_ONLY = "1"

# For the bios recipe
HOSTTOOLS += "pdftotext"

# Set http server's root
WWWDIR = "${datadir}/www/localhost/html"

# Prefer mdns over avahi-libnss-mdns
PREFERRED_RPROVIDER_libnss-mdns = "mdns"

# Specific to TI
TI_COMMON_DEPLOY = "${TOPDIR}/tmp/deploy"

PACKAGE_CLASSES ?= "package_rpm"

SANITY_TESTED_DISTROS = " \
	ubuntu-24.04\n"

# QA check settings - a little stricter than the OE-Core defaults
WARN_TO_ERROR_QA = "already-stripped compile-host-path install-host-path \
                    installed-vs-shipped ldflags pn-overrides rpaths     \
                    staticdev unknown-configure-option useless-rpaths"
WARN_QA:remove = "${WARN_TO_ERROR_QA}"
ERROR_QA:append = " ${WARN_TO_ERROR_QA}"
WARN_QA:append = "shebang-size"
ERROR_QA:remove = "shebang-size"

INHERIT += "uninative"

BB_SIGNATURE_HANDLER ?= "OEEquivHash"
BB_HASHSERVE ??= "auto"
BB_HASHSERVE_DB_DIR = "${SSTATE_DIR}"
```

## meta-oe/recipes-graphics/lvgl/files/defconfig
```kconfig
CONFIG_LV_USE_CLIB_MALLOC=y
CONFIG_LV_USE_CLIB_STRING=y
CONFIG_LV_USE_CLIB_SPRINTF=y
CONFIG_LV_OS_PTHREAD=y
CONFIG_LV_COLOR_DEPTH_32=y
CONFIG_LV_DEF_REFR_PERIOD=16
CONFIG_LV_DRAW_LAYER_SIMPLE_BUF_SIZE=262144
CONFIG_LV_DRAW_THREAD_STACK_SIZE=65536
# CONFIG_LV_BUILD_EXAMPLES is not set
# CONFIG_LV_BUILD_DEMOS is not set
```
