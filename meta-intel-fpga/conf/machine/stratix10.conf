## meta-intel-fpga/conf/machine/stratix10.conf
```bitbake
#@TYPE: Machine
#@NAME: Intel SoCFPGA Stratix10
#@DESCRIPTION: Machine configuration for the Stratix 10 SoCFPGA

require conf/machine/include/socfpga_armv8a.inc

KBUILD_DEFCONFIG ?= "defconfig"

UBOOT_CONFIG ??= "stratix10-socdk-atf"
UBOOT_CONFIG[stratix10-socdk] = "socfpga_stratix10_legacy_defconfig"
UBOOT_CONFIG[stratix10-socdk-atf] = "socfpga_stratix10_defconfig"
UBOOT_CONFIG[stratix10-socdk-qspi] = "socfpga_stratix10_qspi_legacy_defconfig"
UBOOT_CONFIG[stratix10-socdk-qspi-atf] = "socfpga_stratix10_defconfig"

UBOOT_BINARY = "u-boot.itb"
UBOOT_SUFFIX = "itb"

KERNEL_CLASSES:append = " kernel-fitimage"
KERNEL_IMAGETYPE = "Image"

KERNEL_DEVICETREE ?= "altera/socfpga_stratix10_socdk.dtb"
UBOOT_ENTRYPOINT = "0x4000000"
UBOOT_LOADADDRESS = "0x4000000"
FIT_KERNEL_COMP_ALG = "none"

SERIAL_CONSOLES ?= "115200;ttyS0"

EXTRA_IMAGECMD:jffs2 ?= "-n -q -e 0x10000"

UBOOT_EXTLINUX ?= "1"
UBOOT_EXTLINUX_LABELS ?= "default"
UBOOT_EXTLINUX_DEFAULT_LABEL ?= "Stratix10 SOCDK SDMMC"

UBOOT_EXTLINUX_MENU_DESCRIPTION:default ?= "Stratix10 SOCDK SDMMC"
UBOOT_EXTLINUX_KERNEL_IMAGE:default ?= "../${KERNEL_IMAGETYPE}"
UBOOT_EXTLINUX_FDTDIR:default ?= ".."
UBOOT_EXTLINUX_CONSOLE ?= "console=ttyS0,115200n8"
UBOOT_EXTLINUX_KERNEL_ARGS:default ?= "rootwait rw earlyprintk"
UBOOT_EXTLINUX_ROOT:default ?= "root=/dev/mmcblk0p2"

# Add variables for wic creation of sdcard image
IMAGE_BOOT_FILES ?= " \
			${UBOOT_BINARY} \
			Image \
			socfpga_stratix10_socdk.dtb \
		    "

WKS_FILE ?= "sdimage-stratix10-agilex.wks"
IMAGE_FSTYPES:append = " wic"
```

## meta-intel-fpga/files/sdimage-agilex-hypervisor.wks
```
# short-description: Create SD card image for the Altera hypervisor build
# long-description: Creates a partitioned SD card image for the Altera
# hypervisor build. Boot files are located in the first vfat partition.

part --source bootimg-partition --ondisk mmcblk --fstype=vfat --mkfs-extraopts "-F 32" --label boot --active --align 1024 --fixed-size 500M --system-id b
part / --source rootfs --ondisk mmcblk --fstype=ext4 --label root --align 1024 --fixed-size 2000M
```

## meta-intel-fpga/wic/sdimage-arria10.wks
```
# short-description: Create an SD card image for the Arria 10 SoC.
# long-description: Create an SD card image for the Arria 10 SoC.
# Boot files are located in the first vfat partition and u-Boot is located in
# the third partition.

part --source bootimg-partition --ondisk mmcblk --fstype=vfat --mkfs-extraopts "-F 32" --label boot --active --align 1024 --fixed-size 500M --system-id b
part / --source rootfs --ondisk mmcblk --fstype=ext4 --label root --align 1024 --fixed-size 1500M
part --source rawcopy --sourceparams="file=u-boot-splx4.sfp" --ondisk mmcblk --system-id=a2 --align 1024 --fixed-size 10M
```

## meta-mingw/conf/layer.conf
```bitbake
# We have a conf and classes directory, add to BBPATH
BBPATH := "${BBPATH}:${LAYERDIR}"

# We have a packages directory, add to BBFILES
BBFILES += "${LAYERDIR}/recipes*/*/*.bb ${LAYERDIR}/recipes*/*/*.bbappend"
BBFILES_DYNAMIC += "\
    openembedded-layer:${LAYERDIR}/dynamic-layers/openembedded-layer/recipes-*/*/*.bb \
    openembedded-layer:${LAYERDIR}/dynamic-layers/openembedded-layer/recipes-*/*/*.bbappend \
"

BBFILE_COLLECTIONS += "meta-mingw"
BBFILE_PATTERN_meta-mingw := "^${LAYERDIR}/"
BBFILE_PRIORITY_meta-mingw = "8"

addpylib ${LAYERDIR}/lib oeqa

LAYERDEPENDS_meta-mingw = "core"

LAYERSERIES_COMPAT_meta-mingw = "whinlatter"
```

## meta-tango/conf/layer.conf
```bitbake
# We have a conf and classes directory, add to BBPATH
BBPATH .= ":${LAYERDIR}"

# We have recipes-* directories, add to BBFILES
BBFILES += "${LAYERDIR}/recipes-*/*/*.bb \
	    ${LAYERDIR}/recipes-*/*/*.bbappend"

BBFILE_COLLECTIONS += "tango"
BBFILE_PATTERN_tango = "^${LAYERDIR}/"
BBFILE_PRIORITY_tango = "5"

LAYERSERIES_COMPAT_tango = "kirkstone scarthgap walnascar"

# This should only be incremented on significant changes that will
# cause compatibility issues with other layers
LAYERVERSION_tango = "1"

LAYERDEPENDS_tango = "core"
```

## meta-virtualization/conf/distro/include/container-host-containerd.conf
```bitbake
# Container host configuration fragment: Containerd
#
# Include from local.conf to set up a containerd-based container host.
# Requires meta-virt-host.conf to be included first:
#
#   require conf/distro/include/meta-virt-host.conf
#   require conf/distro/include/container-host-containerd.conf
#   MACHINE = "qemux86-64"
#   bitbake container-image-host
#
# Sets CONTAINER_PROFILE and the DISTRO_FEATURES required by
# container-image-host with the containerd engine stack.

CONTAINER_PROFILE = "containerd"
```

## meta-virtualization/conf/distro/include/container-host-incus.conf
```bitbake
# Container host configuration fragment: Incus
#
# Include from local.conf to set up an Incus-based container host.
# Requires meta-virt-host.conf to be included first:
#
#   require conf/distro/include/meta-virt-host.conf
#   require conf/distro/include/container-host-incus.conf
#   MACHINE = "qemux86-64"
#   bitbake container-image-host
#
# Sets CONTAINER_PROFILE for Incus, a system container and VM manager
# built on LXC. Incus replaces LXD as the community container manager
# from linuxcontainers.org.

CONTAINER_PROFILE = "incus"
```

## meta-virtualization/conf/distro/include/container-host-k3s-node.conf
```bitbake
# Container host configuration fragment: K3s agent node
#
# Include from local.conf to set up a K3s agent (worker) node.
# Requires meta-virt-host.conf to be included first:
#
#   require conf/distro/include/meta-virt-host.conf
#   require conf/distro/include/container-host-k3s-node.conf
#   MACHINE = "qemux86-64"
#   bitbake container-image-host
#
# Sets CONTAINER_PROFILE and the DISTRO_FEATURES required by
# container-image-host with K3s agent-only orchestration. The
# k3s-node profile bundles the k3s agent, embedded containerd,
# and CNI plugins. The node joins an existing k3s server cluster.

CONTAINER_PROFILE = "k3s-node"

DISTRO_FEATURES:append = " k3s"
```

## meta-virtualization/conf/distro/include/container-host-k3s.conf
```bitbake
# Container host configuration fragment: K3s server
#
# Include from local.conf to set up a K3s server (control plane + agent).
# Requires meta-virt-host.conf to be included first:
#
#   require conf/distro/include/meta-virt-host.conf
#   require conf/distro/include/container-host-k3s.conf
#   MACHINE = "qemux86-64"
#   bitbake container-image-host
#
# Sets CONTAINER_PROFILE and the DISTRO_FEATURES required by
# container-image-host with K3s orchestration. The k3s-host profile
# bundles the k3s server, embedded containerd, and CNI plugins.

CONTAINER_PROFILE = "k3s-host"

DISTRO_FEATURES:append = " k3s"
```

## meta-virtualization/conf/distro/include/container-host-podman.conf
```bitbake
# Container host configuration fragment: Podman
#
# Include from local.conf to set up a Podman-based container host.
# Requires meta-virt-host.conf to be included first:
#
#   require conf/distro/include/meta-virt-host.conf
#   require conf/distro/include/container-host-podman.conf
#   MACHINE = "qemux86-64"
#   bitbake container-image-host
#
# Sets CONTAINER_PROFILE and the DISTRO_FEATURES required by
# container-image-host with the Podman engine stack.
# Includes ipv6 which is required by the podman packagegroup.

CONTAINER_PROFILE = "podman"

DISTRO_FEATURES:append = " ipv6"
```

## meta-virtualization/conf/distro/include/container-registry.conf
```bitbake
# Container registry configuration fragment
#
# Include from local.conf to enable a local development registry:
#
#   require conf/distro/include/container-registry.conf
#
# Defaults to an insecure (HTTP) registry at localhost:5000 with
# namespace "yocto". Override any variable after the require line.
#
# This fragment enables the container-registry IMAGE_FEATURES, which
# installs registry configuration into the target rootfs (daemon.json
# for Docker, registries.conf.d/ for Podman/containerd).
#
# For a secure (TLS + authentication) registry, override these after
# the require:
#
#   CONTAINER_REGISTRY_URL = "registry.example.com:5000"
#   CONTAINER_REGISTRY_SECURE = "1"
#   CONTAINER_REGISTRY_USERNAME = "myuser"
#   # Optional: enable htpasswd authentication
#   CONTAINER_REGISTRY_AUTH = "1"
#   # Optional: custom namespace
#   CONTAINER_REGISTRY_NAMESPACE = "myproject"

CONTAINER_REGISTRY_URL ?= "localhost:5000"
CONTAINER_REGISTRY_NAMESPACE ?= "yocto"
CONTAINER_REGISTRY_INSECURE ?= "1"

IMAGE_FEATURES:append = " container-registry"
```

## meta-virtualization/conf/distro/include/meta-virt-container-incus.inc
```bitbake
include meta-virt-container.inc

# Incus is a system container and VM manager built on LXC.
# It does not use the OCI container engine/runtime/networking model.
VIRTUAL-RUNTIME_container_engine ??= "incus"
VIRTUAL-RUNTIME_container_runtime ??= ""
VIRTUAL-RUNTIME_container_networking ??= ""
VIRTUAL-RUNTIME_container_dns ??= ""
VIRTUAL-RUNTIME_container_orchestration ??= ""
```

## meta-virtualization/conf/distro/include/meta-virt-container-podman.inc
```bitbake
include meta-virt-container.inc

VIRTUAL-RUNTIME_container_engine ?= "podman"
VIRTUAL-RUNTIME_container_runtime ?= "crun"
# netavark is the only supported network backend since podman 6.0
# (containers/common removed CNI support entirely)
VIRTUAL-RUNTIME_container_networking ?= "netavark"
VIRTUAL-RUNTIME_container_dns ?= "aardvark-dns"
VIRTUAL-RUNTIME_container_orchestration ?= ""

## Kubernetes terminology "components"
VIRTUAL-RUNTIME_cri ?= "virtual-containerd"
VIRTUAL-RUNTIME_cni ?= "cni"
```
