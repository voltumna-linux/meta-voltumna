## meta-virtualization/conf/distro/include/vcontainer-bbmask.inc
```bitbake
# SPDX-FileCopyrightText: Copyright (C) 2025 Bruce Ashfield
#
# SPDX-License-Identifier: MIT
#
# BBMASK for vcontainer OCI image builder multiconfig builds.
#
# Lighter than vruntime's BBMASK: masks recipes irrelevant to container
# image construction (virtualization platforms, graphics, multimedia,
# desktop, orchestration) but keeps OCI tooling (umoci, skopeo),
# container image recipes, and the full container stack available.
#
# The vruntime BBMASK cannot be reused directly because it masks umoci,
# container-registry, recipes-extended/images/, and other recipes needed
# for OCI image building. BitBake BBMASK is append-only (no removal),
# so a separate lighter mask is required.

# ---------------------------------------------------------------------------
# oe-core: same masks as vruntime (graphics, multimedia, sato, rt)
# These are irrelevant to container image building.
# ---------------------------------------------------------------------------
BBMASK += "/meta/recipes-graphics/(?!wayland|libsdl2|virglrenderer|libepoxy|drm|mesa|spir|xorg-lib|xorg-proto|xorg-app|xorg-util)"
BBMASK += "/meta/recipes-multimedia/(?!alsa|libpng)"
BBMASK += "/meta/recipes-sato/"
BBMASK += "/meta/recipes-rt/"
BBMASK += "meta-yocto-bsp/recipes-graphics/xorg-xserver/xserver-xf86-config"
BBMASK += "meta-erlang/recipes-graphics/mesa/libglu"

# ---------------------------------------------------------------------------
# meta-virtualization: virtualization platforms (not containers)
# Same as vruntime — Xen, libvirt, etc. are irrelevant for OCI images.
# ---------------------------------------------------------------------------
BBMASK += "meta-virtualization/recipes-extended/xen/"
BBMASK += "meta-virtualization/recipes-extended/xvisor/"
BBMASK += "meta-virtualization/recipes-extended/kvmtool/"
BBMASK += "meta-virtualization/recipes-extended/libvirt/"
BBMASK += "meta-virtualization/recipes-extended/libvmi/"
BBMASK += "meta-virtualization/recipes-extended/virt-manager/"
BBMASK += "meta-virtualization/recipes-extended/virt-viewer/"
BBMASK += "meta-virtualization/recipes-extended/virt-what/"
BBMASK += "meta-virtualization/recipes-extended/vhost-device/"
BBMASK += "meta-virtualization/recipes-extended/dev86/"
BBMASK += "meta-virtualization/recipes-extended/seabios/"
BBMASK += "meta-virtualization/recipes-extended/vgabios/"
BBMASK += "meta-virtualization/recipes-extended/upx/"
BBMASK += "meta-virtualization/recipes-extended/uxen/"
BBMASK += "meta-virtualization/recipes-extended/ipxe/"
BBMASK += "meta-virtualization/recipes-extended/diod/"
BBMASK += "meta-virtualization/recipes-extended/virtiofsd/"

# ---------------------------------------------------------------------------
# meta-virtualization: infrastructure / monitoring
# ---------------------------------------------------------------------------
BBMASK += "meta-virtualization/recipes-extended/ceph/"
BBMASK += "meta-virtualization/recipes-extended/cloud-init/"
BBMASK += "meta-virtualization/recipes-extended/cockpit-machines/"
BBMASK += "meta-virtualization/recipes-extended/nagios/"
BBMASK += "meta-virtualization/recipes-extended/oath/"
BBMASK += "meta-virtualization/recipes-extended/irqbalance/"

# ---------------------------------------------------------------------------
# meta-virtualization: container orchestration / tools not needed for images
# ---------------------------------------------------------------------------
BBMASK += "meta-virtualization/recipes-containers/kubernetes/"
BBMASK += "meta-virtualization/recipes-containers/k3s/"
BBMASK += "meta-virtualization/recipes-containers/cri-o/"
BBMASK += "meta-virtualization/recipes-containers/cri-tools/"
BBMASK += "meta-virtualization/recipes-containers/docker-compose/"
BBMASK += "meta-virtualization/recipes-containers/podman-compose/"
BBMASK += "meta-virtualization/recipes-containers/podman-tui/"
BBMASK += "meta-virtualization/recipes-containers/nerdctl/"
BBMASK += "meta-virtualization/recipes-containers/buildah/"
BBMASK += "meta-virtualization/recipes-containers/singularity/"
BBMASK += "meta-virtualization/recipes-containers/lxc/"
BBMASK += "meta-virtualization/recipes-containers/lxcfs/"
BBMASK += "meta-virtualization/recipes-containers/criu/"

# ---------------------------------------------------------------------------
# meta-virtualization: other categories not needed for container images
# ---------------------------------------------------------------------------
BBMASK += "meta-virtualization/recipes-demo/"
BBMASK += "meta-virtualization/recipes-graphics/"
BBMASK += "meta-virtualization/recipes-core/kata-containers/"
BBMASK += "meta-virtualization/recipes-core/runx/"
BBMASK += "meta-virtualization/recipes-networking/openvswitch/"
BBMASK += "meta-virtualization/recipes-networking/netns/"
BBMASK += "meta-virtualization/recipes-networking/passt/"

# ---------------------------------------------------------------------------
# meta-oe / meta-networking: mask heavyweight categories
# ---------------------------------------------------------------------------
BBMASK += "meta-oe/recipes-(?!devtools|extended|support)"
BBMASK += "meta-networking/recipes-(?!filter|support)"
BBMASK += "meta-openstack/recipes-dbs/postgresql/"
BBMASK += "meta-oe/dynamic-layers/networking-layer/recipes-core/"
BBMASK += "meta-openstack/recipes-extended/libvirt/"

# ---------------------------------------------------------------------------
# Entire layers with 0 recipes in the container image dependency graph.
# Clear BBFILE_COLLECTIONS entries for fully-masked layers so BitBake
# does not warn about zero files matching BBFILE_PATTERN.
# ---------------------------------------------------------------------------
BBMASK += "meta-filesystems/"
BBMASK += "meta-python/"
BBMASK += "meta-webserver/"
# Warning suppression for these fully-masked layers is in meta-virt-host.conf
# (BBFILE_PATTERN_IGNORE_EMPTY) because BitBake checks the base datastore,
# not per-multiconfig datastores.

# ---------------------------------------------------------------------------
# NOT MASKED (differs from vruntime):
#   recipes-extended/images/          - container image recipes
#   recipes-containers/umoci/         - OCI image manipulation
#   recipes-containers/container-registry/ - registry push
#   recipes-containers/oci-image-tools/    - OCI tooling
#   recipes-containers/oci-image-spec/     - OCI spec
#   recipes-containers/sloci-image/        - simple OCI image builder
#   recipes-containers/oci-base-images/    - external base images
#   recipes-extended/container-bundles/    - container bundling
#   recipes-extended/container-cross-deploy/ - cross-install
#   recipes-extended/fuse-overlayfs/       - overlay support
#   recipes-extended/rootlesskit/          - rootless containers
# ---------------------------------------------------------------------------
```

## meta-virtualization/conf/distro/vruntime.conf
```bitbake
# SPDX-FileCopyrightText: Copyright (C) 2025 Bruce Ashfield
#
# SPDX-License-Identifier: MIT
#
# VRuntime - Minimal distro for vdkr/vpdmn container runtime environments
#
# This distro is used by multiconfig builds (vruntime-aarch64, vruntime-x86-64)
# to create minimal rootfs images for QEMU-based container processing.
#
# IMPORTANT: This distro does NOT participate in CONTAINER_PROFILE.
# The vdkr/vpdmn rootfs images explicitly specify their container stacks
# to avoid conflicts between docker (runc) and podman (crun) requirements.
# This allows both to be built in the same multiconfig.

require conf/distro/include/vruntime-base.inc

# Mask recipes not needed by vruntime container runtime builds.
# Generated from bitbake -g dependency graph analysis.
# Each file can be commented out independently to disable masking for that layer.
require conf/distro/include/vruntime-bbmask.inc
require conf/distro/include/vruntime-bbmask-oe-core.inc
require conf/distro/include/vruntime-bbmask-meta-oe.inc

DISTRO = "vruntime"
DISTRO_NAME = "VRuntime Minimal"
DISTRO_VERSION = "1.0"

# Default to ext4, but image recipes may override to squashfs
IMAGE_FSTYPES = "ext4"

# Use busybox init for minimal footprint
# The vdkr/vpdmn images use custom /init scripts anyway
VIRTUAL-RUNTIME_init_manager = "busybox"
VIRTUAL-RUNTIME_initscripts = "initscripts"

# Disable unnecessary features
VIRTUAL-RUNTIME_login_manager = ""

# Disable ptest for glib-2.0 -- its -ptest RDEPENDS pulls
# cairo -> fontconfig -> freetype (entire graphics stack) via
# python3-dbusmock -> python3-pygobject, all masked in vruntime.
PTEST_ENABLED:pn-glib-2.0 = ""

# =============================================================================
# Container runtime: NOT SET
# =============================================================================
# Unlike normal container distros, vruntime does NOT set CONTAINER_PROFILE
# or VIRTUAL-RUNTIME_container_runtime. This prevents containerd/podman from
# pulling a specific runtime via RDEPENDS, avoiding conflicts when both
# vdkr (runc) and vpdmn (crun) are built in the same multiconfig.
#
# The vdkr-rootfs-image and vpdmn-rootfs-image recipes explicitly install
# their required runtimes in IMAGE_INSTALL.
# =============================================================================
VIRTUAL-RUNTIME_container_runtime = ""
VIRTUAL-RUNTIME_container_engine = ""
VIRTUAL-RUNTIME_container_networking = ""
VIRTUAL-RUNTIME_container_dns = ""
VIRTUAL-RUNTIME_container_orchestration = ""

# Ensure the unified runc recipe is the provider -- vdkr-rootfs-image
# RDEPENDS on runc directly. Strong assignment to override any stale
# cache or weak defaults.
PREFERRED_PROVIDER_virtual/runc = "runc"
```

## meta-virtualization/files/wic/efi-xen-x86-64.wks
```
# short-description: Create an EFI disk image with Xen hypervisor
# long-description: Creates a GPT partitioned UEFI disk image that boots Xen
# via GRUB chainloading xen.efi.  For use with OVMF (QEMU), Hyper-V Gen 2
# VMs, and any other UEFI firmware.
#
# GRUB is installed as the default EFI boot application (bootx64.efi) for
# broad firmware compatibility.  Its grub.cfg chainloads xen.efi, which
# handles Xen/dom0 boot using native EFI boot services.
#
# Test with OVMF:
#   runqemu xen-image-minimal wic nographic slirp kvm ovmf qemuparams="-m 4096"
#
# Convert to VHDX for Hyper-V:
#   qemu-img convert -f raw -O vhdx xen-image-minimal-*.wic xen-image-minimal.vhdx

part /boot --source bootimg-efixen --ondisk sda --label boot --active --align 1024 --part-type C12A7328-F81F-11D2-BA4B-00A0C93EC93B

# Rootfs partition -- add --size 10G or larger for VM storage
part / --source rootfs --ondisk sda --use-uuid --fstype=ext4 --label root --align 1024

bootloader --ptable gpt --timeout=5 --append="dom0_mem=512M noreboot console=com1,vga com1=115200,8n1 loglvl=all guest_loglvl=all --- console=hvc0 earlyprintk=xen root=/dev/sda2 rootwait"
```

## wic/grub-bootdisk.wks
```
part /boot --source bootimg-efi-wo-kernel --sourceparams="loader=grub-efi" --ondisk sda --label boot --active --align 1024 --fixed-size 32M
part / --source rootfs --ondisk sda --fstype=ext4 --label root --align 1024
bootloader --ptable gpt --configfile="${DEPLOY_DIR_IMAGE}/grub-${IMAGE_LINK_NAME}.cfg"
```

## wic/sdimage-2part.wks
```
part /boot --source bootimg-partition-w-uEnv --sourceparams="loader=u-boot,install-kernel-into-boot-dir=false" --ondisk mmcblk0 --label boot --active --align 1024 --fixed-size 32
part / --source rootfs --ondisk mmcblk0 --fstype=ext4 --label root --align 1024
bootloader --ptable msdos --configfile="${DEPLOY_DIR_IMAGE}/uEnv-${IMAGE_LINK_NAME}.txt"
```

## wic/sdimage-stratix10-agilex.wks
```
# short-description: Create SD card image for the Intel Stratix 10 SoC
# long-description: Creates a partitioned SD card image for the Intel
# Stratix 10 SoC. Boot files are located in the first vfat partition.

part --source bootimg-partition --ondisk mmcblk --fstype=vfat --mkfs-extraopts "-F 32" --label boot --active --align 1024 --fixed-size 500M --system-id b
part / --source rootfs --ondisk mmcblk --fstype=ext4 --label root --align 1024 --fixed-size 1500M
```
